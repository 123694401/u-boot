/dts-v1/;

#include <dt-bindings/input/linux-event-codes.h>
#include <dt-bindings/pwm/pwm.h>
#include <dt-bindings/input/input.h>
#include <dt-bindings/usb/pd.h>
#include "rk3399.dtsi"
#include "rk3399-opp.dtsi"
// 降频opp
// #include "rk3399-t-opp.dtsi"

/ {
	compatible = "rockchip,sl339am", "rockchip,rk3399-mid","rockchip,rk3399";
	interrupt-parent = <0x01>;
	#address-cells = <0x02>;
	#size-cells = <0x02>;
    model = "Rockchip RK3399 SL339AM Reboot Board";

	memory {
		reg = <0x00 0x200000 0x00 0x8200000 0x00 0xa200000 0x00 0xede00000>;
		device_type = "memory";
	};

	ddr_timing: ddr_timing {
		compatible = "rockchip,ddr-timing";
		ddr3_speed_bin = <0x15>;
		pd_idle = <0x00>;
		sr_idle = <0x00>;
		sr_mc_gate_idle = <0x00>;
		srpd_lite_idle = <0x00>;
		standby_idle = <0x00>;
		auto_lp_dis_freq = <0x29a>;
		ddr3_dll_dis_freq = <0x12c>;
		phy_dll_dis_freq = <0x104>;
		ddr3_odt_dis_freq = <0x29a>;
		ddr3_drv = <0x28>;
		ddr3_odt = <0x78>;
		phy_ddr3_ca_drv = <0x28>;
		phy_ddr3_dq_drv = <0x28>;
		phy_ddr3_odt = <0xf0>;
		lpddr3_odt_dis_freq = <0x29a>;
		lpddr3_drv = <0x22>;
		lpddr3_odt = <0xf0>;
		phy_lpddr3_ca_drv = <0x22>;
		phy_lpddr3_dq_drv = <0x22>;
		phy_lpddr3_odt = <0xf0>;
		lpddr4_odt_dis_freq = <0x320>;
		lpddr4_drv = <0xf0>;
		lpddr4_dq_odt = <0x28>;
		lpddr4_ca_odt = <0x00>;
		phy_lpddr4_ca_drv = <0x28>;
		phy_lpddr4_ck_cs_drv = <0x28>;
		phy_lpddr4_dq_drv = <0x3c>;
		phy_lpddr4_odt = <0x28>;
		phandle = <0x8e>;
	};

	
	
	cpus {
		//#address-cells = <0x02>;
		//#size-cells = <0x00>;

		cpu-map {

			cluster0 {

				core0 {
					cpu = <&cpu_l0>;
				};

				core1 {
					cpu = <&cpu_l1>;
				};

				core2 {
					cpu = <&cpu_l2>;
				};

				core3 {
					cpu = <&cpu_l3>;
				};
			};

			cluster1 {

				core0 {
					cpu = <&cpu_b0>;
				};

				core1 {
					cpu = <&cpu_b1>;
				};
			};
		};

		

		idle-states {
			entry-method = "psci";

			
		};
	};

	dummy_cpll {
		compatible = "fixed-clock";
		clock-frequency = <0x00>;
		clock-output-names = "dummy_cpll";
		#clock-cells = <0x00>;
	};

	dummy_vpll {
		compatible = "fixed-clock";
		clock-frequency = <0x00>;
		clock-output-names = "dummy_vpll";
		#clock-cells = <0x00>;
	};

	amba {
		compatible = "arm,amba-bus";
		#address-cells = <0x02>;
		#size-cells = <0x02>;
		ranges;

		
	};

	

	usb@fe340000 {
		compatible = "generic-ehci";
		reg = <0x00 0xfe340000 0x00 0x30000>;
		interrupts = <0x00 0x21 0x04 0x00>;
		clocks = <&cru 0x1cc 0x08 0x79 0x08 0x154>;
		clock-names = "hclk_hsic", "clk_hsicphy", "pclk_hsicphy";
		rockchip-has-usic;
		status = "disabled";
	};


    interrupt-controller@fee00000 {
		compatible = "arm,gic-v3";
		#interrupt-cells = <0x04>;
		#address-cells = <0x02>;
		#size-cells = <0x02>;
		ranges;
		interrupt-controller;
		reg = <0x00 0xfee00000 0x00 0x10000 0x00 0xfef00000 0x00 0xc0000 0x00 0xfff00000 0x00 0x10000 0x00 0xfff10000 0x00 0x10000 0x00 0xfff20000 0x00 0x10000>;
		interrupts = <0x01 0x09 0x04 0x00>;
		phandle = <0x01>;

		interrupt-controller@fee20000 {
			compatible = "arm,gic-v3-its";
			msi-controller;
			reg = <0x00 0xfee20000 0x00 0x20000>;
			phandle = <0x85>;
		};

		ppi-partitions {

			interrupt-partition-0 {
				affinity = <0x02 0x03 0x04 0x05>;
				phandle = <0x13>;
			};

			interrupt-partition-1 {
				affinity = <0x06 0x07>;
				phandle = <0x14>;
			};
		};
	};
	


	iep@ff670000 {
		compatible = "rockchip,iep";
		iommu_enabled = <0x01>;
		iommus = <0x92>;
		reg = <0x00 0xff670000 0x00 0x800>;
		interrupts = <0x00 0x2a 0x04 0x00>;
		clocks = <&cru 0xe1 0x08 0x1dd>;
		clock-names = "aclk_iep", "hclk_iep";
		power-domains = <&power RK3399_PD_IEP>;
		allocator = <0x01>;
		version = <0x02>;
		status = "okay";
	};


	watchdog@ff848000 {
		compatible = "snps,dw-wdt";
		reg = <0x00 0xff848000 0x00 0x100>;
		clocks = <&cru 0x17c>;
		interrupts = <0x00 0x78 0x04 0x00>;
	};


	voppwm@ff8f01a0 {
		compatible = "rockchip,vop-pwm";
		reg = <0x00 0xff8f01a0 0x00 0x10>;
		#pwm-cells = <0x03>;
		pinctrl-names = "active";
		pinctrl-0 = <0xa3>;
		clocks = <&cru 0x6c>;
		clock-names = "pwm";
		status = "disabled";
	};

	voppwm@ff9001a0 {
		compatible = "rockchip,vop-pwm";
		reg = <0x00 0xff9001a0 0x00 0x10>;
		#pwm-cells = <0x03>;
		pinctrl-names = "active";
		pinctrl-0 = <0xaa>;
		clocks = <&cru 0x6b>;
		clock-names = "pwm";
		status = "disabled";
	};


	rkisp1@ff910000 { 

		compatible = "rockchip,rk3399-rkisp1";
		reg = <0x00 0xff910000 0x00 0x4000>;
		interrupts = <0x00 0x2b 0x04 0x00>;
		clocks = <&cru 0x6e 0x08 0xe5 0x08 0x1df 0x08 0xe9 0x08 0x1e3>;
		clock-names = "clk_isp", "aclk_isp", "hclk_isp", "aclk_isp_wrap", "hclk_isp_wrap";
		devfreq = <0xab>;
		power-domains = <&power RK3399_PD_ISP0>;
		iommus = <0xac>;
		status = "disabled";
	};


	rkisp1@ff920000 {
		compatible = "rockchip,rk3399-rkisp1";
		reg = <0x00 0xff920000 0x00 0x4000>;
		interrupts = <0x00 0x2c 0x04 0x00>;
		clocks = <&cru 0x6f 0x08 0xe6 0x08 0x1e0 0x08 0xea 0x08 0x1e4>;
		clock-names = "clk_isp", "aclk_isp", "hclk_isp", "aclk_isp_wrap", "hclk_isp_wrap";
		devfreq = <0xab>;
		power-domains = <&power RK3399_PD_ISP1>;
		iommus = <0xad>;
		status = "disabled";
	};

	
	hdmi-hdcp2@ff988000 {
		compatible = "rockchip,rk3399-hdmi-hdcp2";
		reg = <0x00 0xff988000 0x00 0x2000>;
		interrupts = <0x00 0x16 0x04 0x00>;
		clocks = <&cru 0xe0 0x08 0x176 0x08 0x1e9>;
		clock-names = "aclk_hdcp2", "pclk_hdcp2", "hdcp2_clk_hdmi";
		status = "disabled";
	};

	display-subsystem {
		compatible = "rockchip,display-subsystem";
		ports = <0xbc 0xbd>;
		clocks = <&cru 0x07 0x08 0x04>;
		clock-names = "hdmi-tmds-pll", "default-vop-pll";
		devfreq = <0xab>;
		status = "okay";
		logo-memory-region = <0xbe>;
		secure-memory-region = <0xbf>;

		route {

			route-hdmi {
				overscan,bottom_margin = <0x64>;
				overscan,top_margin = <0x64>;
				overscan,right_margin = <0x64>;
				overscan,left_margin = <0x64>;
				video,flags = <0x00>;
				video,vrefresh = <0x00>;
				video,crtc_vsync_end = <0x00>;
				video,crtc_hsync_end = <0x00>;
				video,vdisplay = <0x00>;
				video,hdisplay = <0x00>;
				logo,ymirror = <0x01>;
				logo,bpp = <0x18>;
				logo,height = <0x194>;
				logo,width = <0x400>;
				logo,offset = <0x13007a>;
				status = "okay";
				logo,uboot = "logo.bmp";
				logo,kernel = "logo_kernel.bmp";
				logo,mode = "center";
				charge_logo,mode = "center";
				connect = <0xb0>;
			};

			route-dsi {
				status = "okay";
				logo,uboot = "logo_reverse.bmp";
				logo,kernel = "logo_kernel_reverse.bmp";
				logo,mode = "center";
				charge_logo,mode = "center";
				connect = <0xb1>;
			};

			route-dsi1 {
				status = "disabled";
				logo,uboot = "logo.bmp";
				logo,kernel = "logo_kernel.bmp";
				logo,mode = "center";
				charge_logo,mode = "center";
				connect = <0xb7>;
			};

			route-edp {
				status = "disabled";
				logo,uboot = "logo_reverse.bmp";
				logo,kernel = "logo_kernel_reverse.bmp";
				logo,mode = "center";
				charge_logo,mode = "center";
				connect = <0xb9>;
			};
		};
	};

	nocp-cci-msch0@ffa86000 {
		compatible = "rockchip,rk3399-nocp";
		reg = <0x00 0xffa86000 0x00 0x400>;
	};

	nocp-gpu-msch0@ffa86400 {
		compatible = "rockchip,rk3399-nocp";
		reg = <0x00 0xffa86400 0x00 0x400>;
	};

	nocp-hp-msch0@ffa86800 {
		compatible = "rockchip,rk3399-nocp";
		reg = <0x00 0xffa86800 0x00 0x400>;
	};

	nocp-lp-msch0@ffa86c00 {
		compatible = "rockchip,rk3399-nocp";
		reg = <0x00 0xffa86c00 0x00 0x400>;
	};

	nocp-video-msch0@ffa87000 {
		compatible = "rockchip,rk3399-nocp";
		reg = <0x00 0xffa87000 0x00 0x400>;
	};

	nocp-vio0-msch0@ffa87400 {
		compatible = "rockchip,rk3399-nocp";
		reg = <0x00 0xffa87400 0x00 0x400>;
	};

	nocp-vio1-msch0@ffa87800 {
		compatible = "rockchip,rk3399-nocp";
		reg = <0x00 0xffa87800 0x00 0x400>;
	};

	nocp-cci-msch1@ffa8e000 {
		compatible = "rockchip,rk3399-nocp";
		reg = <0x00 0xffa8e000 0x00 0x400>;
	};

	nocp-gpu-msch1@ffa8e400 {
		compatible = "rockchip,rk3399-nocp";
		reg = <0x00 0xffa8e400 0x00 0x400>;
	};

	nocp-hp-msch1@ffa8e800 {
		compatible = "rockchip,rk3399-nocp";
		reg = <0x00 0xffa8e800 0x00 0x400>;
	};

	nocp-lp-msch1@ffa8ec00 {
		compatible = "rockchip,rk3399-nocp";
		reg = <0x00 0xffa8ec00 0x00 0x400>;
	};

	nocp-video-msch1@ffa8f000 {
		compatible = "rockchip,rk3399-nocp";
		reg = <0x00 0xffa8f000 0x00 0x400>;
	};

	nocp-vio0-msch1@ffa8f400 {
		compatible = "rockchip,rk3399-nocp";
		reg = <0x00 0xffa8f400 0x00 0x400>;
	};

	nocp-vio1-msch1@ffa8f800 {
		compatible = "rockchip,rk3399-nocp";
		reg = <0x00 0xffa8f800 0x00 0x400>;
	};

	rockchip-suspend {
		compatible = "rockchip,pm-rk3399";
		status = "okay";
		rockchip,sleep-debug-en = <0x01>;
		rockchip,virtual-poweroff = <0x00>;
		rockchip,sleep-mode-config = <0xfe>;
		rockchip,wakeup-config = <0x04>;
		rockchip,pwm-regulator-config = <0x04>;
		rockchip,power-ctrl = <0x34 0x11 0x00 0x34 0x0e 0x00>;
	};

	chosen {
		stdout-path = "serial2:115200n8";
	};

	cpuinfo {
		compatible = "rockchip,cpuinfo";
		nvmem-cells = <0xc5>;
		nvmem-cell-names = "id";
	};

	ramoops_mem {
		reg = <0x00 0x110000 0x00 0xf0000>;
		reg-names = "ramoops_mem";
		phandle = <0xc6>;
	};

	ramoops {
		compatible = "ramoops";
		record-size = <0x00 0x20000>;
		console-size = <0x00 0x80000>;
		ftrace-size = <0x00 0x00>;
		pmsg-size = <0x00 0x50000>;
		memory-region = <0xc6>;
	};

	fiq-debugger {
		compatible = "rockchip,fiq-debugger";
		rockchip,serial-id = <0x02>;
		rockchip,wake-irq = <0x00>;
		rockchip,irq-mode-enable = <0x00>;
		rockchip,baudrate = <0x16e360>;
		pinctrl-names = "default";
		pinctrl-0 = <0x45>;
		interrupts = <0x00 0x96 0x04 0x00>;
	};

	reserved-memory {
		#address-cells = <0x02>;
		#size-cells = <0x02>;
		ranges;

		drm-logo@00000000 {
			compatible = "rockchip,drm-logo";
			reg = <0x00 0xf5c00000 0x00 0x25f07a>;
			phandle = <0xbe>;
		};

		secure-memory@20000000 {
			compatible = "rockchip,secure-memory";
			reg = <0x00 0x20000000 0x00 0x10000000>;
			status = "disabled";
			phandle = <0xbf>;
		};

		stb-devinfo@00000000 {
			compatible = "rockchip,stb-devinfo";
			reg = <0x00 0x00 0x00 0x00>;
		};
	};

	rockchip-key {
		compatible = "rockchip,key";
		status = "okay";
		io-channels = <0xc7 0x01>;

		vol-up-key {
			linux,code = <0x73>;
			label = "volume down";
			rockchip,adc_value = <0x01>;
		};

		vol-down-key {
			linux,code = <0x72>;
			label = "volume up";
			rockchip,adc_value = <0xaa>;
		};

		home-key {
			linux,code = <0x66>;
			label = "home";
			rockchip,adc_value = <0xfa>;
		};

		esc-key {
			linux,code = <0x9e>;
			label = "back";
			rockchip,adc_value = <0x1a4>;
		};

		oem-key {
			linux,code = <0x3b>;
			label = "f1";
			rockchip,adc_value = <0x276>;
		};

		power-key {
			gpios = <0x3b 0x05 0x01>;
			linux,code = <0x74>;
			label = "power";
			gpio-key,wakeup;
		};
	};

	isp@ff910000 {
		compatible = "rockchip,rk3399-isp", "rockchip,isp";
		reg = <0x00 0xff910000 0x00 0x4000>;
		interrupts = <0x00 0x2b 0x04 0x00>;
		clocks = <&cru 0x89 0x08 0x89 0x08 0xa4 0x08 0x77 0x08 0xe7 0x08 0xe9 0x08 0x1e1 0x08 0x1e3 0x08 0x6e 0x08 0xa5>;
		clock-names = "clk_cif_out", "clk_cif_pll", "pclk_dphytxrx", "pclk_dphy_ref", "aclk_isp0_noc", "aclk_isp0_wrapper", "hclk_isp0_noc", "hclk_isp0_wrapper", "clk_isp0", "pclk_dphyrx";
		pinctrl-names = "cif_clkout", "isp_dvp8bit0", "isp_mipi_fl", "isp_mipi_fl_prefl";
		pinctrl-0 = <0xc8>;
		pinctrl-1 = <0xc8 0xc9>;
		pinctrl-2 = <0xc8>;
		pinctrl-3 = <0xc8 0xca>;
		rockchip,isp,mipiphy = <0x02>;
		rockchip,isp,cifphy = <0x01>;
		rockchip,isp,dsiphy,reg = <0xff968000 0x8000>;
		rockchip,grf = <&grf>;
		rockchip,cru = <0x08>;
		rockchip,gpios = <0x34 0x03 0x00>;
		rockchip,isp,iommu-enable = <0x01>;
		power-domains = <&power RK3399_PD_ISP0>;
		iommus = <0xac>;
		status = "okay";
	};

	isp@ff920000 {
		compatible = "rockchip,rk3399-isp", "rockchip,isp";
		reg = <0x00 0xff920000 0x00 0x4000>;
		interrupts = <0x00 0x2c 0x04 0x00>;
		clocks = <&cru 0xe8 0x08 0xea 0x08 0x1e2 0x08 0x1e4 0x08 0x6f 0x08 0x89 0x08 0x89 0x08 0xa4 0x08 0x77 0x08 0x17b 0x08 0xa5 0x08 0x171 0x08 0x78>;
		clock-names = "aclk_isp1_noc", "aclk_isp1_wrapper", "hclk_isp1_noc", "hclk_isp1_wrapper", "clk_isp1", "clk_cif_out", "clk_cif_pll", "pclk_dphytxrx", "pclk_dphy_ref", "pclk_isp1", "pclk_dphyrx", "pclk_mipi_dsi", "mipi_dphy_cfg";
		pinctrl-names = "cif_clkout", "isp_dvp8bit0", "isp_mipi_fl", "isp_mipi_fl_prefl";
		pinctrl-0 = <0xc8>;
		pinctrl-1 = <0xc9>;
		pinctrl-2 = <0xc8>;
		pinctrl-3 = <0xca>;
		rockchip,isp,mipiphy = <0x02>;
		rockchip,isp,cifphy = <0x01>;
		rockchip,isp,dsiphy,reg = <0xff968000 0x8000>;
		rockchip,grf = <&grf>;
		rockchip,cru = <0x08>;
		rockchip,gpios = <0x34 0x03 0x00>;
		rockchip,isp,iommu-enable = <0x01>;
		power-domains = <&power RK3399_PD_ISP1>;
		iommus = <0xad>;
		status = "okay";
	};

	uboot-charge {
		compatible = "rockchip,uboot-charge";
		rockchip,uboot-charge-on = <0x01>;
		rockchip,android-charge-on = <0x00>;
	};

	hdmi-dp-sound {
		status = "disabled";
		compatible = "rockchip,rk3399-hdmi-dp";
		rockchip,cpu = <0xcb>;
		rockchip,codec = <0xcc 0xcd>;
	};

	energy-costs {

		rk3399-core-cost0 {
			busy-cost-data = <0x6c 0x2e 0x9f 0x43 0xd8 0x5a 0x10b 0x78 0x13e 0x99 0x177 0xc6 0x191 0xde>;
			idle-cost-data = <0x06 0x06 0x00 0x00>;
			phandle = <0x0c>;
		};

		rk3399-core-cost1 {
			busy-cost-data = <0xd2 0x81 0x134 0xb8 0x1a3 0xf6 0x206 0x14f 0x269 0x1ac 0x2d8 0x23d 0x33b 0x2d4 0x39d 0x384 0x400 0x454>;
			idle-cost-data = <0x0f 0x0f 0x00 0x00>;
			phandle = <0x10>;
		};

		rk3399-cluster-cost0 {
			busy-cost-data = <0x6c 0x2e 0x9f 0x43 0xd8 0x5a 0x10b 0x78 0x13e 0x99 0x177 0xc6 0x191 0xde>;
			idle-cost-data = <0x38 0x38 0x38 0x38>;
			phandle = <0x0d>;
		};

		rk3399-cluster-cost1 {
			busy-cost-data = <0xd2 0x81 0x134 0xb8 0x1a3 0xf6 0x206 0x14f 0x269 0x1ac 0x2d8 0x23d 0x33b 0x2d4 0x39d 0x384 0x400 0x454>;
			idle-cost-data = <0x41 0x41 0x41 0x41>;
			phandle = <0x11>;
		};
	};


	opp-table3 {
		compatible = "operating-points-v2";
		phandle = <0x8f>;

		opp-200000000 {
			opp-hz = <0x00 0xbebc200>;
			opp-microvolt = <0xdbba0>;
		};

		opp-300000000 {
			opp-hz = <0x00 0x11e1a300>;
			opp-microvolt = <0xdbba0>;
		};

		opp-400000000 {
			opp-hz = <0x00 0x17d78400>;
			opp-microvolt = <0xdbba0>;
		};

		opp-528000000 {
			opp-hz = <0x00 0x1f78a400>;
			opp-microvolt = <0xdbba0>;
		};

		opp-600000000 {
			opp-hz = <0x00 0x23c34600>;
			opp-microvolt = <0xdbba0>;
		};

		opp-800000000 {
			opp-hz = <0x00 0x2faf0800>;
			opp-microvolt = <0xdbba0>;
		};
	};

	edp-panel {
		status = "disabled";
		compatible = "simple-panel";
		backlight = <0xb3>;
		power-supply = <0xb4>;
		enable-gpios = <0x3c 0x1a 0x00>;

		ports {

			endpoint {
				remote-endpoint = <0xd2>;
				phandle = <0xbb>;
			};
		};

		display-timings {
			native-mode = <0xd3>;

			timing0 {
				clock-frequency = <0x8459d60>;
				hactive = <0x780>;
				vactive = <0x438>;
				hfront-porch = <0x50>;
				hsync-len = <0x32>;
				hback-porch = <0x1e>;
				vfront-porch = <0x0c>;
				vsync-len = <0x10>;
				vback-porch = <0x04>;
				hsync-active = <0x00>;
				vsync-active = <0x00>;
				de-active = <0x00>;
				pixelclk-active = <0x00>;
				phandle = <0xd3>;
			};
		};
	};

	vcc5v0-sys {
		compatible = "regulator-fixed";
		regulator-name = "vcc5v0_sys";
		regulator-always-on;
		regulator-boot-on;
		regulator-min-microvolt = <0x4c4b40>;
		regulator-max-microvolt = <0x4c4b40>;
	};

	

	vcc5v0-host-regulator {
		compatible = "regulator-fixed";
		enable-active-high;
		gpio = <0x3c 0x1d 0x00>;
		pinctrl-names = "default";
		pinctrl-0 = <0xd4>;
		regulator-name = "vcc5v0_host";
		regulator-always-on;
		regulator-boot-on;

		regulator-state-mem {
			regulator-off-in-suspend;
		};
	};

	otg-vbus-regulator {
		compatible = "regulator-fixed";
		enable-active-high;
		regulator-name = "vcc_otg_vbus";
		regulator-always-on;
		regulator-boot-on;
		regulator-min-microvolt = <0x4c4b40>;
		regulator-max-microvolt = <0x4c4b40>;

		regulator-state-mem {
			regulator-off-in-suspend;
		};
	};

	vdd-log {
		compatible = "pwm-regulator";
		pwms = <0xd5 0x00 0x61a8 0x01>;
		rockchip,pwm_id = <0x02>;
		rockchip,pwm_voltage = <0xdbba0>;
		regulator-name = "vdd_log";
		regulator-min-microvolt = <0xb71b0>;
		regulator-max-microvolt = <0x149970>;
		regulator-always-on;
		regulator-boot-on;
	};

	backlight {
		compatible = "pwm-backlight";
		pwms = <0xd6 0x00 0x61a8 0x00>;
		brightness-levels = <0xff 0xfe 0xfd 0xfc 0xfb 0xfa 0xf9 0xf8 0xf7 0xf6 0xf5 0xf4 0xf3 0xf2 0xf1 0xf0 0xef 0xee 0xed 0xec 0xeb 0xea 0xe9 0xe8 0xe7 0xe6 0xe5 0xe4 0xe3 0xe2 0xe1 0xe0 0xdf 0xde 0xdd 0xdc 0xdb 0xda 0xd9 0xd8 0xd7 0xd6 0xd5 0xd4 0xd3 0xd2 0xd1 0xd0 0xcf 0xce 0xcd 0xcc 0xcb 0xca 0xc9 0xc8 0xc7 0xc6 0xc5 0xc4 0xc3 0xc2 0xc1 0xc0 0x123 0xbe 0xbd 0xbc 0xbb 0xba 0xb9 0xb8 0xb7 0xb6 0xb5 0xb4 0xb3 0xb2 0xb1 0xb0 0xaf 0xae 0xad 0xac 0xab 0xaa 0xa9 0xa8 0xa7 0xa6 0xa5 0xa4 0xa3 0xa2 0xa1 0xa0 0x9f 0x9e 0x9d 0x9c 0x9b 0x9a 0x99 0x98 0x97 0x96 0x95 0x94 0x93 0x92 0x91 0x90 0x8f 0x8e 0x8d 0x8c 0x8b 0x8a 0x89 0x88 0x87 0x86 0x85 0x84 0x83 0x82 0x81 0x80 0x7f 0x7e 0x7d 0x7c 0x7b 0x7a 0x79 0x78 0x77 0x76 0x75 0x74 0x73 0x72 0x71 0x70 0x6f 0x6e 0x6d 0x6c 0x6b 0x6a 0x69 0x68 0x67 0x66 0x65 0x64 0x63 0x62 0x61 0x60 0x5f 0x5e 0x5d 0x5c 0x5b 0x5a 0x59 0x58 0x57 0x56 0x55 0x54 0x53 0x52 0x51 0x50 0x4f 0x4e 0x4d 0x4c 0x4b 0x4a 0x49 0x48 0x47 0x46 0x45 0x44 0x43 0x42 0x41 0x40 0x3f 0x3e 0x3d 0x3c 0x3b 0x3a 0x39 0x38 0x37 0x36 0x35 0x34 0x33 0x32 0x31 0x30 0x2f 0x2e 0x2d 0x2c 0x2b 0x2a 0x29 0x28 0x27 0x26 0x25 0x24 0x23 0x22 0x21 0x20 0x1f 0x1e 0x1d 0x1c 0x1b 0x1a 0x19 0x18 0x17 0x16 0x15 0x14 0x13 0x12 0x11 0x10 0x0f 0x0e 0x0d 0x0c 0x0b 0x0a 0x09 0x08 0x07 0x06 0x05 0x04 0x03 0x02 0x01 0x00>;
		default-brightness-level = <0xc8>;
		enable-gpios = <0x34 0x01 0x00>;
		phandle = <0xb3>;
	};

	
	external-gmac-clock {
		compatible = "fixed-clock";
		clock-frequency = <0x7735940>;
		clock-output-names = "clkin_gmac";
		#clock-cells = <0x00>;
		phandle = <0x19>;
	};

	es8316-sound {
		compatible = "simple-audio-card";
		simple-audio-card,format = "i2s";
		simple-audio-card,name = "rockchip,es8316-codec";
		simple-audio-card,mclk-fs = <0x100>;
		simple-audio-card,widgets = "Microphone\0Mic Jack\0Headphone\0Headphone Jack";
		simple-audio-card,routing = "Mic Jack\0MICBIAS1\0IN1P\0Mic Jack\0Headphone Jack\0HPOL\0Headphone Jack\0HPOR";

		simple-audio-card,cpu {
			sound-dai = <0xd7>;
		};

		simple-audio-card,codec {
			sound-dai = <0xd8>;
		};
	};

	

	xfm10213-sound {
		status = "disabled";
		compatible = "simple-audio-card";
		simple-audio-card,format = "left_j";
		simple-audio-card,mclk-fs = <0x100>;
		simple-audio-card,name = "rockchip,xmf10213";

		simple-audio-card,cpu {
			sound-dai = <0xd9>;
		};

		simple-audio-card,codec {
			bitclock-master;
			frame-master;
			sound-dai = <0xda>;
		};
	};

	

	wireless-wlan {
		compatible = "wlan-platdata";
		rockchip,grf = <&grf>;
		wifi_chip_type = "ap6212";
		sdio_vref = <0x708>;
		WIFI,host_wake_irq = <0x3b 0x03 0x00>;
		status = "okay";
	};

	wireless-bluetooth {
		compatible = "bluetooth-platdata";
		clocks = <0xdb 0x01>;
		clock-names = "ext_clock";
		uart_rts_gpios = <0xdd 0x13 0x01>;
		pinctrl-names = "default", "rts_gpio";
		pinctrl-0 = <0xde>;
		pinctrl-1 = <0xdf>;
		BT,reset_gpio = <0x3b 0x09 0x00>;
		BT,wake_gpio = <0xdd 0x1a 0x00>;
		BT,wake_host_irq = <0x3b 0x04 0x00>;
		status = "okay";
	};

	rk_headset {
		compatible = "rockchip_headset";
		headset_gpio = <0x3c 0x1c 0x01>;
		pinctrl-names = "default";
		pinctrl-0 = <0xe0>;
		io-channels = <0xc7 0x02>;
	};

	rk_adc1 {
		status = "okay";
		compatible = "rk_adc1";
		io-channels = <0xc7 0x00>;
	};

	rk_adc2 {
		status = "okay";
		compatible = "rk_adc2";
		io-channels = <0xc7 0x02>;
	};

	comstar_gpio {
		compatible = "comstar,oem-gpio";
		status = "okay";
		pinctrl-0 = <0xdd 0x00 0x00>;
		pinctrl-1 = <0xdd 0x01 0x00>;
		pinctrl-2 = <0xdd 0x02 0x00>;
		pinctrl-3 = <0xdd 0x03 0x00>;
		pinctrl-4 = <0xdd 0x04 0x00>;
		pinctrl-5 = <0xdd 0x05 0x00>;
		pinctrl-6 = <0xdd 0x06 0x00>;
		pinctrl-7 = <0xdd 0x07 0x00>;
		modem_pwr_rst = <0x34 0x00 0x00>;
		modem_pwr_on = <0x3b 0x0d 0x01>;
	};

	sys_led {
		compatible = "comstar,sys-led";
		sysled-gpio = <0x34 0x18 0x00>;
	};

	flash_led {
		compatible = "comstar,flash-led";
		flashled-gpio = <0x34 0x03 0x00>;
	};

	usb_host_vbus {
		compatible = "comstar,usb-host-vbus";
		vbus-gpio = <0x3c 0x1d 0x00>;
	};

	pwm-leds {
		compatible = "pwm-leds";
		status = "okay";

		cam_led {
			label = "cam_led";
			active-low;
			pwms = <0xe1 0x00 0x61a8 0x00>;
			max-brightness = <0xff>;
		};
	};
};

&aliases {
		mmc0 = &sdio0;
		mmc1 = &sdmmc;
		mmc2 = &sdhci;
};

		&cpu_l0 {
			//device_type = "cpu";
			compatible = "arm,cortex-a53", "arm,armv8";
			//reg = <0x00 0x00>;
			//enable-method = "psci";
			//#cooling-cells = <0x02>;
			//clocks = <&cru ARMCLKL>;
			//cpu-idle-states = <&CPU_SLEEP &CLUSTER_SLEEP>;
			//dynamic-power-coefficient = <100>;
			//operating-points-v2 = <0x0b>;
			//sched-energy-costs = <0x0c 0x0d>;
			cpu-supply = <0x0e>;
			phandle = <0x02>;
		};

		&cpu_l1 {
			//device_type = "cpu";
			//compatible = "arm,cortex-a53", "arm,armv8";
			//reg = <0x00 0x01>;
			//enable-method = "psci";
			//clocks = <&cru 0x08>;
			//cpu-idle-states = <&CPU_SLEEP &CLUSTER_SLEEP>;
			//dynamic-power-coefficient = <100>;
			//operating-points-v2 = <0x0b>;
			//sched-energy-costs = <0x0c 0x0d>;
			cpu-supply = <0x0e>;
			phandle = <0x03>;
		};

		&cpu_l2 {
			//device_type = "cpu";
			//compatible = "arm,cortex-a53", "arm,armv8";
			//reg = <0x00 0x02>;
			//enable-method = "psci";
			//clocks = <&cru 0x08>;
			//cpu-idle-states = <&CPU_SLEEP &CLUSTER_SLEEP>;
			//dynamic-power-coefficient = <100>;
			//operating-points-v2 = <0x0b>;
			//sched-energy-costs = <0x0c 0x0d>;
			cpu-supply = <0x0e>;
			phandle = <0x04>;
		};

		&cpu_l3 {
			//device_type = "cpu";
			//compatible = "arm,cortex-a53", "arm,armv8";
			//reg = <0x00 0x03>;
			//enable-method = "psci";
			//clocks = <&cru 0x08>;
			//cpu-idle-states = <&CPU_SLEEP &CLUSTER_SLEEP>;
			//dynamic-power-coefficient = <100>;
			//operating-points-v2 = <0x0b>;
			//sched-energy-costs = <0x0c 0x0d>;
			cpu-supply = <0x0e>;
			phandle = <0x05>;
		};

		&cpu_b0 {
			//device_type = "cpu";
			//compatible = "arm,cortex-a72", "arm,armv8";
			//reg = <0x00 0x100>;
			///enable-method = "psci";
			//#cooling-cells = <0x02>;
			//clocks = <&cru ARMCLKB>;
			//cpu-idle-states = <&CPU_SLEEP &CLUSTER_SLEEP>;
			//dynamic-power-coefficient = <436>;
			//operating-points-v2 = <0x0f>;
			//sched-energy-costs = <0x10 0x11>;
			cpu-supply = <0x12>;
			phandle = <0x06>;
		};

		&cpu_b1 {
			//device_type = "cpu";
			//compatible = "arm,cortex-a72", "arm,armv8";
			//reg = <0x00 0x101>;
			//enable-method = "psci";
			//clocks = <&cru ARMCLKB>;
			//cpu-idle-states = <&CPU_SLEEP &CLUSTER_SLEEP>;
			//dynamic-power-coefficient = <436>;
			//operating-points-v2 = <0x0f>;
			//sched-energy-costs = <0x10 0x11>;
			cpu-supply = <0x12>;
			phandle = <0x07>;
		};

		&CPU_SLEEP {
				//compatible = "arm,idle-state";
				//local-timer-stop;
				//arm,psci-suspend-param = <0x10000>;
				//entry-latency-us = <120>;
				//exit-latency-us = <250>;
				//min-residency-us = <900>;
				phandle = <0x09>;
			};

			&CLUSTER_SLEEP {
				//compatible = "arm,idle-state";
				//local-timer-stop;
				//arm,psci-suspend-param = <0x1010000>;
				//entry-latency-us = <400>;
				//exit-latency-us = <500>;
				//min-residency-us = <2000>;
				phandle = <0x0a>;
			};

			/* dmac_bus: dma-controller@ff6d0000 { */
		&dmac_bus {
			//compatible = "arm,pl330", "arm,primecell";
			//reg = <0x00 0xff6d0000 0x00 0x4000>;

			//interrupts = <GIC_SPI 5 IRQ_TYPE_LEVEL_HIGH 0>,
			//     <GIC_SPI 6 IRQ_TYPE_LEVEL_HIGH 0>;
			//#dma-cells = <1>;

			//clocks = <&cru ACLK_DMAC0_PERILP>;
			//clock-names = "apb_pclk";
			peripherals-req-type-burst;
			phandle = <0x97>;
		};

		/* dmac_peri: dma-controller@ff6e0000 { */
		&dmac_peri {
			//compatible = "arm,pl330", "arm,primecell";
			//reg = <0x00 0xff6e0000 0x00 0x4000>;

			//interrupts = <GIC_SPI 7 IRQ_TYPE_LEVEL_HIGH 0>,
			//     <GIC_SPI 8 IRQ_TYPE_LEVEL_HIGH 0>;
			//#dma-cells = <1>;

			//clocks = <&cru ACLK_DMAC1_PERILP>;
			//clock-names = "apb_pclk";
			peripherals-req-type-burst;
		};

		/* gmac: ethernet@fe300000 { */
	&gmac {
		//compatible = "rockchip,rk3399-gmac";
		//reg = <0x00 0xfe300000 0x00 0x10000>;
		//rockchip,grf = <&grf>;
		//interrupts = <GIC_SPI 12 IRQ_TYPE_LEVEL_HIGH 0>;
		//interrupt-names = "macirq";

		//clocks = <&cru SCLK_MAC>, <&cru SCLK_MAC_RX>,
		//	 <&cru SCLK_MAC_TX>, <&cru SCLK_MACREF>,
		//	 <&cru SCLK_MACREF_OUT>, <&cru ACLK_GMAC>,
		//	 <&cru PCLK_GMAC>;
		//clock-names = "stmmaceth", "mac_clk_rx", "mac_clk_tx", "clk_mac_ref", "clk_mac_refout", "aclk_mac", "pclk_mac";
		//resets = <&cru SRST_A_GMAC>;
		//reset-names = "stmmaceth";
		//power-domains = <&power RK3399_PD_GMAC>;
		status = "okay";
		phy-supply = <0x17>;
		phy-mode = "rgmii";
		clock_in_out = "input";
		snps,reset-gpio = <0x18 0x0f 0x01>;
		snps,reset-active-low;
		snps,reset-delays-us = <0x00 0x2710 0xc350>;
		assigned-clocks = <&cru 0xa6>;
		assigned-clock-parents = <0x19>;
		pinctrl-names = "default";
		pinctrl-0 = <0x1a>;
		tx_delay = <0x28>;
		rx_delay = <0x11>;
	};

/* 	sdio0: dwmmc@fe310000 { */
	&sdio0 {
		//compatible = "rockchip,rk3399-dw-mshc", "rockchip,rk3288-dw-mshc";
		//reg = <0x00 0xfe310000 0x00 0x4000>;
		//interrupts = <0x00 0x40 0x04 0x00>;
		clock-freq-min-max = <0x30d40 0x8f0d180>;
		//clocks = <&cru 0x1ee 0x08 0x4d 0x08 0x9c 0x08 0x9d>;
		//clock-names = "biu", "ciu", "ciu-drive", "ciu-sample";
		//fifo-depth = <0x100>;
		//power-domains = <&power RK3399_PD_SDIOAUDIO>;
		status = "okay";
		clock-frequency = <0x8f0d180>;
		supports-sdio;
		bus-width = <0x04>;
		disable-wp;
		cap-sd-highspeed;
		cap-sdio-irq;
		keep-power-in-suspend;
		mmc-pwrseq = <0x1b>;
		non-removable;
		num-slots = <0x01>;
		pinctrl-names = "default";
		pinctrl-0 = <0x1c 0x1d 0x1e>;
		sd-uhs-sdr104;
	};

	/* sdmmc: dwmmc@fe320000 { */
	&sdmmc {
		//compatible = "rockchip,rk3399-dw-mshc", "rockchip,rk3288-dw-mshc";
		//reg = <0x00 0xfe320000 0x00 0x4000>;
		//interrupts = <0x00 0x41 0x04 0x00>;
		clock-freq-min-max = <0x61a80 0x8f0d180>;
		//clocks = <&cru  0x1ce>, <&cru  0x4c>, <&cru  0x9a>, <0x08 0x9b>;
		//clock-names = "biu", "ciu", "ciu-drive", "ciu-sample";
		//fifo-depth = <0x100>;
		//power-domains = <&power RK3399_PD_SD>;
		status = "okay";
		clock-frequency = <0x2faf080>;
		supports-sd;
		bus-width = <0x04>;
		cap-mmc-highspeed;
		cap-sd-highspeed;
		disable-wp;
		num-slots = <0x01>;
		vqmmc-supply = <0x1f>;
		pinctrl-names = "default";
		pinctrl-0 = <0x20 0x21 0x22 0x23>;
	};

	/* sdhci: sdhci@fe330000 { */
	&sdhci {
		//compatible = "rockchip,rk3399-sdhci-5.1", "arasan,sdhci-5.1";
		//reg = <0x00 0xfe330000 0x00 0x10000>;
		//interrupts = <0x00 0x0b 0x04 0x00>;
		//arasan,soc-ctl-syscon = <&grf>;
		//assigned-clocks = <&cru 0x4e>;
		//assigned-clock-rates = <200000000>;

		//clocks = <&cru SCLK_EMMC>, <&cru ACLK_EMMC>;
		//clock-names = "clk_xin", "clk_ahb";
		//clock-output-names = "emmc_cardclock";
		//#clock-cells = <0>;
		//phys = <&emmc_phy>;
		//phy-names = "phy_arasan";
		//power-domains = <&power RK3399_PD_EMMC>;
		status = "okay";
		assigned-clock-parents = <0x08 0x05>;
		bus-width = <0x08>;
		mmc-hs400-1_8v;
		supports-emmc;
		non-removable;
		keep-power-in-suspend;
		mmc-hs400-enhanced-strobe;
		phandle = <0x96>;
	};

	
	/* usb_host0_ehci: usb@fe380000 { */
	&usb_host0_ehci {
		//compatible = "generic-ehci";
		//reg = <0x00 0xfe380000 0x00 0x20000>;
		//interrupts = <0x00 0x1a 0x04 0x00>;
		//clocks = <&cru 0x1c8 0x08 0x1c9 0x08 0xa8>;
		clock-names = "hclk_host0", "hclk_host0_arb", "usbphy0_480m";
		//phys = <&u2phy0_host>;
		//phy-names = "usb";
		power-domains = <&power RK3399_PD_PERIHP>;
		status = "okay";
	};

	/* usb_host0_ohci: usb@fe3a0000 { */
	&usb_host0_ohci {
		//compatible = "generic-ohci";
		//reg = <0x00 0xfe3a0000 0x00 0x20000>;
		//interrupts = <0x00 0x1c 0x04 0x00>;
		//clocks = <&cru 0x1c8 0x08 0x1c9 0x08 0xa8>;
		clock-names = "hclk_host0", "hclk_host0_arb", "usbphy0_480m";
		//phys = <&u2phy0_host>;
		//phy-names = "usb";
		power-domains = <&power RK3399_PD_PERIHP>;
		status = "okay";
	};

	/* usb_host1_ehci: usb@fe3c0000 { */
	&usb_host1_ehci {
		//compatible = "generic-ehci";
		//reg = <0x00 0xfe3c0000 0x00 0x20000>;
		//interrupts = <0x00 0x1e 0x04 0x00>;
		//clocks = <&cru 0x1ca 0x08 0x1cb 0x08 0xa9>;
		clock-names = "hclk_host1", "hclk_host1_arb", "usbphy1_480m";
		//phys = <0x26>;
		//phy-names = "usb";
		power-domains = <&power RK3399_PD_PERIHP>;
		status = "okay";
	};

	/* usb_host1_ohci: usb@fe3e0000 { */
	&usb_host1_ohci {
		//compatible = "generic-ohci";
		//reg = <0x00 0xfe3e0000 0x00 0x20000>;
		//interrupts = <0x00 0x20 0x04 0x00>;
		//clocks = <&cru 0x1ca 0x08 0x1cb 0x08 0xa9>;
		clock-names = "hclk_host1", "hclk_host1_arb", "usbphy1_480m";
		//phys = <0x26>;
		//phy-names = "usb";
		power-domains = <&power RK3399_PD_PERIHP>;
		status = "okay";
	};

	/*usbdrd3_0: usb@fe800000 {*/
	&usbdrd3_0 {
		//compatible = "rockchip,rk3399-dwc3";
		//clocks = <&cru 0x81 0x08 0x83 0x08 0xf6 0x08 0xf9>;
		//clock-names = "ref_clk", "suspend_clk", "bus_clk", "grf_clk";
		//power-domains = <&power RK3399_PD_USB3>;
		//resets = <0x08 0x125>;
		//reset-names = "usb3-otg";
		//#address-cells = <0x02>;
		//#size-cells = <0x02>;
		//ranges;
		status = "okay";
		extcon = <0x27>;
	};

	/*usbdrd_dwc3_0: dwc3@fe800000 {*/
		&usbdrd_dwc3_0 {	
			//compatible = "snps,dwc3";
			//reg = <0x00 0xfe800000 0x00 0x100000>;
			//interrupts = <0x00 0x69 0x04 0x00>;
			//dr_mode = "otg";
			//phys = <0x28 0x29>;
			//phy-names = "usb2-phy", "usb3-phy";
			//phy_type = "utmi_wide";
			///snps,dis_enblslpm_quirk;
			//snps,dis-u2-freeclk-exists-quirk;
			//snps,dis_u2_susphy_quirk;
			//snps,dis-del-phy-power-chg-quirk;
			//snps,tx-ipgap-linecheck-dis-quirk;
			//snps,xhci-slow-suspend-quirk;
			//snps,xhci-trb-ent-quirk;
			///snps,usb3-warm-reset-on-resume-quirk;
			status = "okay";
		};

	/*usbdrd3_1: usb@fe900000 {*/
	&usbdrd3_1 {
		//compatible = "rockchip,rk3399-dwc3";
		//clocks = <&cru 0x82 0x08 0x84 0x08 0xf7 0x08 0xf9>;
		//clock-names = "ref_clk", "suspend_clk", "bus_clk", "grf_clk";
		power-domains = <&power RK3399_PD_USB3>;
		//resets = <0x08 0x126>;
		//reset-names = "usb3-otg";
		//#address-cells = <0x02>;
		//#size-cells = <0x02>;
		//ranges;
		status = "okay";

		
	};

	/*usbdrd_dwc3_1: dwc3@fe900000 {*/
		&usbdrd_dwc3_1 {
			//compatible = "snps,dwc3";
			//reg = <0x00 0xfe900000 0x00 0x100000>;
			//interrupts = <0x00 0x6e 0x04 0x00>;
			dr_mode = "host";
			//phys = <0x2a 0x2b>;
			//phy-names = "usb2-phy", "usb3-phy";
			//phy_type = "utmi_wide";
			//snps,dis_enblslpm_quirk;
			//snps,dis-u2-freeclk-exists-quirk;
			//snps,dis_u2_susphy_quirk;
			//snps,dis-del-phy-power-chg-quirk;
			//snps,tx-ipgap-linecheck-dis-quirk;
			//snps,xhci-slow-suspend-quirk;
			//snps,xhci-trb-ent-quirk;
			//snps,usb3-warm-reset-on-resume-quirk;
			status = "okay";
		};

	/* cdn_dp: dp@fec00000 { */
	&cdn_dp {
		//compatible = "rockchip,rk3399-cdn-dp";
		//reg = <0x00 0xfec00000 0x00 0x100000>;
		//interrupts = <0x00 0x09 0x04 0x00>;
		//clocks = <&cru 0x72 0x08 0x175 0x08 0xa1 0x08 0x16f>;
		clock-names = "core-clk", "pclk", "spdif", "grf";
		assigned-clocks = <&cru 0x72>;
		assigned-clock-rates = <0x5f5e100>;
		//power-domains = <&power RK3399_PD_HDCP>;
		phys = <0x2c 0x2d>;
		//resets = <0x08 0x103 0x08 0x148 0x08 0x14a 0x08 0xfd>;
		//reset-names = "spdif", "dptx", "apb", "core";
		//rockchip,grf = <&grf>;
		#address-cells = <0x01>;
		#size-cells = <0x00>;
		//#sound-dai-cells = <0x01>;
		status = "disabled";
		phandle = <0xcd>;
	};

	/* dp_in_vopb: endpoint@0 { */
		&dp_in_vopb {
			//reg = <0x00>;
			//remote-endpoint = <&vopb_out_dp>;
			phandle = <0xa8>;
		};

		/* dp_in_vopl: endpoint@1 { */
		&dp_in_vopl {
			//reg = <0x01>;
			//remote-endpoint = <&vopl_out_dp>;
			phandle = <0xa1>;
		};
	
	/* saradc: saradc@ff100000 { */
	&saradc {
		//compatible = "rockchip,rk3399-saradc";
		//reg = <0x00 0xff100000 0x00 0x100>;
		//interrupts = <0x00 0x3e 0x04 0x00>;
		//#io-channel-cells = <0x01>;
		//clocks = <&cru 0x50 0x08 0x165>;
		//clock-names = "saradc", "apb_pclk";
		//resets = <0x08 0xd4>;
		//reset-names = "saradc-apb";
		status = "okay";
		phandle = <0xc7>;
	};

	/* i2c0: i2c@ff3c0000 { */
	&i2c0 {
		//compatible = "rockchip,rk3399-i2c";
		//reg = <0x00 0xff3c0000 0x00 0x1000>;
		//clocks = <0x30 0x09 0x30 0x1b>;
		//clock-names = "i2c", "pclk";
		//interrupts = <0x00 0x39 0x04 0x00>;
		//pinctrl-names = "default";
		//pinctrl-0 = <0x31>;
		//#address-cells = <0x01>;
		//#size-cells = <0x00>;
		status = "okay";
		i2c-scl-rising-time-ns = <0xb4>;
		i2c-scl-falling-time-ns = <0x1e>;
		clock-frequency = <0x61a80>;

		vdd_cpu_b: syr837@40 { 
			compatible = "silergy,syr827";
			reg = <0x40>;
			vin-supply = <0x32>;
			regulator-compatible = "fan53555-reg";
			pinctrl-names = "default";
			pinctrl-0 = <0x33>;
			vsel-gpios = <0x34 0x11 0x00>;
			regulator-name = "vdd_cpu_b";
			regulator-min-microvolt = <0xadf34>;
			regulator-max-microvolt = <0x16e360>;
			regulator-ramp-delay = <0x3e8>;
			fcs,suspend-voltage-selector = <0x01>;
			regulator-always-on;
			regulator-boot-on;
			regulator-initial-state = <0x03>;
			phandle = <0x12>;

			regulator-state-mem {
				regulator-off-in-suspend;
			};
		};

		vdd_gpu: syr828@41 {
			compatible = "silergy,syr828";
			status = "okay";
			reg = <0x41>;
			vin-supply = <0x32>;
			regulator-compatible = "fan53555-reg";
			pinctrl-names = "default";
			pinctrl-0 = <0x35>;
			vsel-gpios = <0x34 0x0e 0x00>;
			regulator-name = "vdd_gpu";
			regulator-min-microvolt = <0xadf34>;
			regulator-max-microvolt = <0x16e360>;
			regulator-ramp-delay = <0x3e8>;
			fcs,suspend-voltage-selector = <0x01>;
			regulator-always-on;
			regulator-boot-on;
			regulator-initial-state = <0x03>;
			phandle = <0x9c>;

			regulator-state-mem {
				regulator-off-in-suspend;
			};
		};

		rk808: pmic@1b {
			compatible = "rockchip,rk808";
			reg = <0x1b>;
			interrupt-parent = <&gpio1>;
			interrupts = <0x15 0x08>;
			pinctrl-names = "default";
			pinctrl-0 = <0x36 0x37>;
			rockchip,system-power-controller;
			wakeup-source;
			#clock-cells = <0x01>;
			clock-output-names = "xin32k","rk808-clkout2";
			vcc1-supply = <&vcc3v3_sys>;
			vcc2-supply = <&vcc3v3_sys>;
			vcc3-supply = <&vcc3v3_sys>;
			vcc4-supply = <&vcc3v3_sys>;
			vcc6-supply = <&vcc3v3_sys>;
			vcc7-supply = <&vcc3v3_sys>;
			vcc8-supply = <&vcc3v3_sys>;
			vcc9-supply = <&vcc3v3_sys>;
			vcc10-supply = <&vcc3v3_sys>;
			vcc11-supply = <&vcc3v3_sys>;
			vcc12-supply = <&vcc3v3_sys>;
			vddio-supply = <&vcc1v8_pmu>;
			phandle = <0xdb>;

			regulators {

				vdd_center: DCDC_REG1 {
					regulator-always-on;
					regulator-boot-on;
					regulator-min-microvolt = <1000000>;
					regulator-max-microvolt = <1350000>;
					regulator-ramp-delay = <6001>;
					regulator-name = "vdd_center";

					regulator-state-mem {
						regulator-off-in-suspend;
					};
				};

				vdd_cpu_l: DCDC_REG2 {
					regulator-always-on;
					regulator-boot-on;
					regulator-min-microvolt = <750000>;
					regulator-max-microvolt = <1350000>;
					regulator-ramp-delay = <6001>;
					regulator-name = "vdd_cpu_l";
					phandle = <0x0e>;

					regulator-state-mem {
						regulator-off-in-suspend;
					};
				};

				vcc_ddr: DCDC_REG3 {
					regulator-always-on;
					regulator-boot-on;
					regulator-name = "vcc_ddr";

					regulator-state-mem {
						regulator-on-in-suspend;
					};
				};

				vcc_1v8: DCDC_REG4 {
					regulator-always-on;
					regulator-boot-on;
					regulator-min-microvolt = <1800000>;
					regulator-max-microvolt = <1800000>;
					regulator-name = "vcc_1v8";
					phandle = <0x7b>;

					regulator-state-mem {
						regulator-on-in-suspend;
						regulator-suspend-microvolt = <1800000>;
					};
				};

				vcc1v8_dvp: LDO_REG1 {
					regulator-always-on;
					regulator-boot-on;
					regulator-min-microvolt = <1800000>;
					regulator-max-microvolt = <1800000>;
					regulator-name = "vcc1v8_dvp";
					phandle = <0x93>;

					regulator-state-mem {
						regulator-off-in-suspend;
					};
				};

				vcc3v0_tp: LDO_REG2 {
					regulator-always-on;
					regulator-boot-on;
					regulator-min-microvolt = <3300000>;
					regulator-max-microvolt = <3300000>;
					regulator-name = "vcc3v0_tp";
					phandle = <0x83>;

					regulator-state-mem {
						regulator-off-in-suspend;
					};
				};

				vcc1v8_pmu: LDO_REG3 {
					regulator-always-on;
					regulator-boot-on;
					regulator-min-microvolt = <1800000>;
					regulator-max-microvolt = <1800000>;
					regulator-name = "vcc1v8_pmu";
					phandle = <0x38>;

					regulator-state-mem {
						regulator-on-in-suspend;
						regulator-suspend-microvolt = <1800000>;
					};
				};

				vcc_sdio: LDO_REG4 {
					regulator-always-on;
					regulator-boot-on;
					regulator-min-microvolt = <1800000>;
					regulator-max-microvolt = <3300000>;
					regulator-name = "vcc_sd";
					phandle = <0x1f>;

					regulator-state-mem {
						regulator-off-in-suspend;
						regulator-suspend-microvolt = <3000000>;
					};
				};

				vcca3v0_codec: LDO_REG5 {
					regulator-always-on;
					regulator-boot-on;
					regulator-min-microvolt = <2800000>;
					regulator-max-microvolt = <2800000>;
					regulator-name = "vcca3v0_codec";

					regulator-state-mem {
						regulator-off-in-suspend;
					};
				};

				vcc_1v5: LDO_REG6 {
					regulator-always-on;
					regulator-boot-on;
					regulator-min-microvolt = <1500000>;
					regulator-max-microvolt = <1500000>;
					regulator-name = "vcc_1v5";

					regulator-state-mem {
						regulator-on-in-suspend;
						regulator-suspend-microvolt = <1500000>;
					};
				};

				vcca1v8_codec: LDO_REG7 {
					regulator-always-on;
					regulator-boot-on;
					regulator-min-microvolt = <1800000>;
					regulator-max-microvolt = <1800000>;
					regulator-name = "vcca1v8_codec";
					phandle = <0x94>;

					regulator-state-mem {
						regulator-off-in-suspend;
					};
				};

				vcc_3v0: LDO_REG8 {
					regulator-always-on;
					regulator-boot-on;
					regulator-min-microvolt = <3000000>;
					regulator-max-microvolt = <3000000>;
					regulator-name = "vcc_3v0";
					phandle = <0x95>;

					regulator-state-mem {
						regulator-on-in-suspend;
						regulator-suspend-microvolt = <3000000>;
					};
				};

				vcc3v3_s3: SWITCH_REG1 {
					regulator-always-on;
					regulator-boot-on;
					regulator-name = "vcc3v3_s3";

					regulator-state-mem {
						regulator-off-in-suspend;
					};
				};

				vcc3v3_s0: SWITCH_REG2 {
					regulator-always-on;
					regulator-boot-on;
					regulator-name = "vcc3v3_s0";
					phandle = <0xb4>;

					regulator-state-mem {
						regulator-off-in-suspend;
					};
				};
			};
		};
	};

	/* i2c1: i2c@ff110000 { */
	&i2c1  {
		//compatible = "rockchip,rk3399-i2c";
		//reg = <0x00 0xff110000 0x00 0x1000>;
		//clocks = <&cru 0x41 0x08 0x155>;
		//clock-names = "i2c", "pclk";
		//interrupts = <0x00 0x3b 0x04 0x00>;
		//pinctrl-names = "default";
		//pinctrl-0 = <0x39>;
		//#address-cells = <0x01>;
		//#size-cells = <0x00>;
		status = "okay";
		i2c-scl-rising-time-ns = <0x8c>;
		i2c-scl-falling-time-ns = <0x1e>;

		es8316@11 {
			#sound-dai-cells = <0x00>;
			compatible = "everest,es8316";
			reg = <0x11>;
			clocks = <&cru 0x59>;
			clock-names = "mclk";
			pinctrl-names = "default";
			pinctrl-0 = <0x3a>;
			spk-con-gpio = <0x3b 0x0b 0x00>;
			phandle = <0xd8>;
		};

		xfm10213@3e {
			status = "disabled";
			#sound-dai-cells = <0x00>;
			compatible = "comstar,xfm10213";
			reg = <0x3e>;
			pinctrl-names = "default";
			int-gpio = <0x18 0x1e 0x00>;
			reset-gpios = <0x3c 0x1b 0x01>;
			phandle = <0xda>;
		};
	};

	/* i2c2: i2c@ff120000 { */
	&i2c2 {
		//compatible = "rockchip,rk3399-i2c";
		//reg = <0x00 0xff120000 0x00 0x1000>;
		//clocks = <&cru 0x42 0x08 0x156>;
		//clock-names = "i2c", "pclk";
		//interrupts = <0x00 0x23 0x04 0x00>;
		//pinctrl-names = "default";
		//pinctrl-0 = <0x3d>;
		//#address-cells = <0x01>;
		//#size-cells = <0x00>;
		status = "disabled";
	};

	/* i2c3: i2c@ff130000 { */
	&i2c3 {
		//compatible = "rockchip,rk3399-i2c";
		//reg = <0x00 0xff130000 0x00 0x1000>;
		//clocks = <&cru 0x43 0x08 0x157>;
		//clock-names = "i2c", "pclk";
		//interrupts = <0x00 0x22 0x04 0x00>;
		//pinctrl-names = "default";
		//pinctrl-0 = <0x3e>;
		//#address-cells = <0x01>;
		//#size-cells = <0x00>;
		status = "disabled";
	};

	/* i2c5: i2c@ff140000 { */
	&i2c5 {
		//compatible = "rockchip,rk3399-i2c";
		//reg = <0x00 0xff140000 0x00 0x1000>;
		//clocks = <&cru 0x44 0x08 0x158>;
		//clock-names = "i2c", "pclk";
		//interrupts = <0x00 0x26 0x04 0x00>;
		//pinctrl-names = "default";
		//pinctrl-0 = <0x3f>;
		//#address-cells = <0x01>;
		//#size-cells = <0x00>;
		status = "disabled";
	};

	/* i2c6: i2c@ff150000 { */
	&i2c6 {
		//compatible = "rockchip,rk3399-i2c";
		//reg = <0x00 0xff150000 0x00 0x1000>;
		//clocks = <&cru 0x45 0x08 0x159>;
		//clock-names = "i2c", "pclk";
		//interrupts = <0x00 0x25 0x04 0x00>;
		//pinctrl-names = "default";
		//pinctrl-0 = <0x40>;
		//#address-cells = <0x01>;
		//#size-cells = <0x00>;
		status = "okay";

		tc258@0f {
			status = "disabled";
			compatible = "comstar,tc358";
			reg = <0x0f>;
		};

		lis3dh {
			compatible = "gs_lis3dh";
			reg = <0x19>;
			type = <0x02>;
			irq-gpio = <0x18 0x1e 0x08>;
			irq_enable = <0x01>;
			poll_delay_ms = <0x1e>;
			layout = <0x01>;
			status = "okay";
		};
	};

	/* i2c7: i2c@ff160000 { */
	&i2c7 {
		//compatible = "rockchip,rk3399-i2c";
		//reg = <0x00 0xff160000 0x00 0x1000>;
		//clocks = <&cru 0x46 0x08 0x15a>;
		//clock-names = "i2c", "pclk";
		//interrupts = <0x00 0x24 0x04 0x00>;
		//pinctrl-names = "default";
		//pinctrl-0 = <0x41>;
		//#address-cells = <0x01>;
		//#size-cells = <0x00>;
		status = "disabled";
	};

	/* uart0: serial@ff180000 { */
	&uart0 {
		compatible = "rockchip,rk3399-uart", "snps,dw-apb-uart";
		reg = <0x00 0xff180000 0x00 0x100>;
		clocks = <&cru 0x51 0x08 0x160>;
		clock-names = "baudclk", "apb_pclk";
		interrupts = <0x00 0x63 0x04 0x00>;
		reg-shift = <0x02>;
		reg-io-width = <0x04>;
		pinctrl-names = "default";
		pinctrl-0 = <0x42 0x43>;
		status = "okay";
		assigned-clocks = <&cru 0xac>;
		assigned-clock-parents = <0x08 0x05>;
	};

	/* uart1: serial@ff190000 { */
	&uart1 {
		compatible = "rockchip,rk3399-uart", "snps,dw-apb-uart";
		reg = <0x00 0xff190000 0x00 0x100>;
		clocks = <&cru 0x52 0x08 0x161>;
		clock-names = "baudclk", "apb_pclk";
		interrupts = <0x00 0x62 0x04 0x00>;
		reg-shift = <0x02>;
		reg-io-width = <0x04>;
		pinctrl-names = "default";
		pinctrl-0 = <0x44>;
		status = "disabled";
		assigned-clocks = <&cru 0xad>;
		assigned-clock-parents = <0x08 0x05>;
	};

	/* uart2: serial@ff1a0000 { */
	&uart2 {
		compatible = "rockchip,rk3399-uart", "snps,dw-apb-uart";
		reg = <0x00 0xff1a0000 0x00 0x100>;
		clocks = <&cru 0x53 0x08 0x162>;
		clock-names = "baudclk", "apb_pclk";
		interrupts = <0x00 0x64 0x04 0x00>;
		reg-shift = <0x02>;
		reg-io-width = <0x04>;
		pinctrl-names = "default";
		pinctrl-0 = <0x45>;
		status = "okay";
		assigned-clocks = <&cru 0xad>;
		assigned-clock-parents = <0x08 0x05>;
	};

	/* uart3: serial@ff1b0000 { */
	&uart3 {
		compatible = "rockchip,rk3399-uart", "snps,dw-apb-uart";
		reg = <0x00 0xff1b0000 0x00 0x100>;
		clocks = <&cru 0x54 0x08 0x163>;
		clock-names = "baudclk", "apb_pclk";
		interrupts = <0x00 0x65 0x04 0x00>;
		reg-shift = <0x02>;
		reg-io-width = <0x04>;
		pinctrl-names = "default";
		pinctrl-0 = <0x46 0x47 0x48>;
		status = "disabled";
		assigned-clocks = <&cru 0xad>;
		assigned-clock-parents = <0x08 0x05>;
	};

	/* spi0: spi@ff1c0000 { */
	&spi0 {
		compatible = "rockchip,rk3399-spi", "rockchip,rk3066-spi";
		reg = <0x00 0xff1c0000 0x00 0x1000>;
		clocks = <&cru 0x47 0x08 0x15b>;
		clock-names = "spiclk", "apb_pclk";
		interrupts = <0x00 0x44 0x04 0x00>;
		pinctrl-names = "default";
		pinctrl-0 = <0x49 0x4a 0x4b 0x4c>;
		#address-cells = <0x01>;
		#size-cells = <0x00>;
		status = "disabled";
	};

	/* spi1: spi@ff1d0000 { */
	&spi1 {
		compatible = "rockchip,rk3399-spi", "rockchip,rk3066-spi";
		reg = <0x00 0xff1d0000 0x00 0x1000>;
		clocks = <&cru 0x48 0x08 0x15c>;
		clock-names = "spiclk", "apb_pclk";
		interrupts = <0x00 0x35 0x04 0x00>;
		pinctrl-names = "default";
		pinctrl-0 = <0x4d 0x4e 0x4f 0x50>;
		#address-cells = <0x01>;
		#size-cells = <0x00>;
		status = "disabled";
		max-freq = <0x2faf080>;

		wk2124@00 {
			status = "disabled";
			compatible = "weikai,wk2168";
			reg = <0x00>;
			spi-max-frequency = <0x4c4b40>;
			irq_gpio = <0x34 0x02 0x08>;
			rst_gpio = <0x34 0x00 0x00>;
		};
	};

	/* spi2: spi@ff1e0000 { */
	&spi2 {
		compatible = "rockchip,rk3399-spi", "rockchip,rk3066-spi";
		reg = <0x00 0xff1e0000 0x00 0x1000>;
		clocks = <&cru 0x49 0x08 0x15d>;
		clock-names = "spiclk", "apb_pclk";
		interrupts = <0x00 0x34 0x04 0x00>;
		pinctrl-names = "default";
		pinctrl-0 = <0x51 0x52 0x53 0x54>;
		#address-cells = <0x01>;
		#size-cells = <0x00>;
		status = "disabled";
	};

	/* spi4: spi@ff1f0000 { */
	&spi4 {
		compatible = "rockchip,rk3399-spi", "rockchip,rk3066-spi";
		reg = <0x00 0xff1f0000 0x00 0x1000>;
		clocks = <&cru 0x4a 0x08 0x15e>;
		clock-names = "spiclk", "apb_pclk";
		interrupts = <0x00 0x43 0x04 0x00>;
		pinctrl-names = "default";
		pinctrl-0 = <0x55 0x56 0x57 0x58>;
		#address-cells = <0x01>;
		#size-cells = <0x00>;
		status = "disabled";
	};

	/* spi5: spi@ff200000 { */
	&spi5 {
		compatible = "rockchip,rk3399-spi", "rockchip,rk3066-spi";
		reg = <0x00 0xff200000 0x00 0x1000>;
		clocks = <&cru 0x4b 0x08 0x15f>;
		clock-names = "spiclk", "apb_pclk";
		interrupts = <0x00 0x84 0x04 0x00>;
		pinctrl-names = "default";
		pinctrl-0 = <0x59 0x5a 0x5b 0x5c>;
		#address-cells = <0x01>;
		#size-cells = <0x00>;
		status = "disabled";
	};

	/*thermal_zones: thermal-zones { */
	&thermal_zones {

		soc-thermal {
			polling-delay-passive = <0x14>;
			polling-delay = <0x3e8>;
			sustainable-power = <0x3e8>;
			thermal-sensors = <0x5d 0x00>;

			trips {

				trip-point-0 {
					temperature = <0x11170>;
					hysteresis = <0x7d0>;
					type = "passive";
				};

				trip-point-1 {
					temperature = <0x14c08>;
					hysteresis = <0x7d0>;
					type = "passive";
					phandle = <0x5e>;
				};

				soc-crit {
					temperature = <0x1c138>;
					hysteresis = <0x7d0>;
					type = "critical";
				};
			};

			cooling-maps {

				map0 {
					trip = <0x5e>;
					cooling-device = <0x02 0xffffffff 0xffffffff>;
					contribution = <0x1000>;
				};

				map1 {
					trip = <0x5e>;
					cooling-device = <0x06 0xffffffff 0xffffffff>;
					contribution = <0x400>;
				};

				map2 {
					trip = <0x5e>;
					cooling-device = <0x5f 0xffffffff 0xffffffff>;
					contribution = <0x1000>;
				};
			};
		};

		gpu-thermal {
			polling-delay-passive = <0x64>;
			polling-delay = <0x3e8>;
			thermal-sensors = <0x5d 0x01>;
		};
	};

	/* tsadc: tsadc@ff260000 { */
	&tsadc{
		compatible = "rockchip,rk3399-tsadc";
		reg = <0x00 0xff260000 0x00 0x100>;
		interrupts = <0x00 0x61 0x04 0x00>;
		rockchip,grf = <&grf>;
		clocks = <&cru 0x4f 0x08 0x164>;
		clock-names = "tsadc", "apb_pclk";
		assigned-clocks = <&cru 0x4f>;
		assigned-clock-rates = <0xb71b0>;
		resets = <0x08 0xe8>;
		reset-names = "tsadc-apb";
		pinctrl-names = "init", "default", "sleep";
		pinctrl-0 = <0x60>;
		pinctrl-1 = <0x61>;
		pinctrl-2 = <0x60>;
		#thermal-sensor-cells = <0x01>;
		rockchip,hw-tshut-temp = <0x1d4c0>;
		status = "okay";
		rockchip,hw-tshut-mode = <0x01>;
		rockchip,hw-tshut-polarity = <0x01>;
		phandle = <0x5d>;
	};

	/* qos_emmc: qos@ffa58000 { */
	&qos_emmc {
		compatible = "rockchip,rk3399-qos", "syscon";
		reg = <0x00 0xffa58000 0x00 0x20>;
		phandle = <0x69>;
	};

	/* qos_gmac: qos@ffa5c000 { */
	&qos_gmac {
		compatible = "syscon";
		reg = <0x00 0xffa5c000 0x00 0x20>;
		phandle = <0x6a>;
	};

	/* qos_pcie: qos@ffa60080 { */
	&qos_pcie {
		compatible = "syscon";
		reg = <0x00 0xffa60080 0x00 0x20>;
		phandle = <0x6c>;
	};

	/* qos_usb_host0: qos@ffa60100 { */
	&qos_usb_host0 {
		compatible = "syscon";
		reg = <0x00 0xffa60100 0x00 0x20>;
		phandle = <0x6d>;
	};

	/* qos_usb_host1: qos@ffa60180 { */
	&qos_usb_host1 {
		compatible = "syscon";
		reg = <0x00 0xffa60180 0x00 0x20>;
		phandle = <0x6e>;
	};

	/* qos_usb_otg0: qos@ffa70000 { */
	&qos_usb_otg0 {
		compatible = "syscon";
		reg = <0x00 0xffa70000 0x00 0x20>;
		phandle = <0x71>;
	};

	/* qos_usb_otg1: qos@ffa70080 { */
	&qos_usb_otg1 {
		compatible = "syscon";
		reg = <0x00 0xffa70080 0x00 0x20>;
		phandle = <0x72>;
	};

	/* qos_sd: qos@ffa74000 { */
	&qos_sd {
		compatible = "syscon";
		reg = <0x00 0xffa74000 0x00 0x20>;
		phandle = <0x6f>;
	};

	/* qos_sdioaudio: qos@ffa76000 { */
	&qos_sdioaudio {
		compatible = "syscon";
		reg = <0x00 0xffa76000 0x00 0x20>;
		phandle = <0x70>;
	};

	/* qos_hdcp: qos@ffa90000 { */
	&qos_hdcp {
		compatible = "syscon";
		reg = <0x00 0xffa90000 0x00 0x20>;
		phandle = <0x73>;
	};

	/* qos_iep: qos@ffa98000 { */
	&qos_iep {
		compatible = "syscon";
		reg = <0x00 0xffa98000 0x00 0x20>;
		phandle = <0x62>;
	};

	/* qos_isp0_m0: qos@ffaa0000 { */
	&qos_isp0_m0 {
		compatible = "syscon";
		reg = <0x00 0xffaa0000 0x00 0x20>;
		phandle = <0x74>;
	};

	/* qos_isp0_m1: qos@ffaa0080 { */
	&qos_isp0_m1 {
		compatible = "syscon";
		reg = <0x00 0xffaa0080 0x00 0x20>;
		phandle = <0x75>;
	};

	/* qos_isp1_m0: qos@ffaa8000 { */
	&qos_isp1_m0 {
		compatible = "syscon";
		reg = <0x00 0xffaa8000 0x00 0x20>;
		phandle = <0x76>;
	};

	/*qos_isp1_m1: qos@ffaa8080 {*/
	&qos_isp1_m1 {

		compatible = "syscon";
		reg = <0x00 0xffaa8080 0x00 0x20>;
		phandle = <0x77>;
	};

	/* qos_rga_r: qos@ffab0000 { */
	&qos_rga_r {
		compatible = "syscon";
		reg = <0x00 0xffab0000 0x00 0x20>;
		phandle = <0x63>;
	};

	/* qos_rga_w: qos@ffab0080 { */
	&qos_rga_w {
		compatible = "syscon";
		reg = <0x00 0xffab0080 0x00 0x20>;
		phandle = <0x64>;
	};

	/* qos_video_m0: qos@ffab8000 { */
	&qos_video_m0 {
		compatible = "syscon";
		reg = <0x00 0xffab8000 0x00 0x20>;
		phandle = <0x65>;
	};

	/* qos_video_m1_r: qos@ffac0000 { */
	&qos_video_m1_r {
		compatible = "syscon";
		reg = <0x00 0xffac0000 0x00 0x20>;
		phandle = <0x66>;
	};

	/* qos_video_m1_w: qos@ffac0080 { */
	&qos_video_m1_w {
		compatible = "syscon";
		reg = <0x00 0xffac0080 0x00 0x20>;
		phandle = <0x67>;
	};

	/* qos_vop_big_r: qos@ffac8000 { */
	&qos_vop_big_r {
		compatible = "syscon";
		reg = <0x00 0xffac8000 0x00 0x20>;
		phandle = <0x78>;
	};

	/* qos_vop_big_w: qos@ffac8080 { */
	&qos_vop_big_w {
		compatible = "syscon";
		reg = <0x00 0xffac8080 0x00 0x20>;
		phandle = <0x79>;
	};

	/* qos_vop_little: qos@ffad0000 { */
	&qos_vop_little {
		compatible = "syscon";
		reg = <0x00 0xffad0000 0x00 0x20>;
		phandle = <0x7a>;
	};

	/* qos_perihp: qos@ffad8080 { */
	&qos_perihp {
		compatible = "syscon";
		reg = <0x00 0xffad8080 0x00 0x20>;
		phandle = <0x6b>;
	};

	/* qos_gpu: qos@ffae0000 { */
	&qos_gpu {
		compatible = "syscon";
		reg = <0x00 0xffae0000 0x00 0x20>;
		phandle = <0x68>;
	};

	/* power: power-controller { */
		&power { 
			//compatible = "rockchip,rk3399-power-controller";
			//#power-domain-cells = <1>;
			//#address-cells = <1>;
			//#size-cells = <0>;
			phandle = <0x16>;
			/*
			pd_iep@34 {
				reg = <0x22>;
				clocks = <0x08 0xe1 0x08 0x1dd>;
				pm_qos = <0x62>;
			};*/
			power-domain@RK3399_PD_IEP {
				reg = <RK3399_PD_IEP>;
				clocks = <&cru ACLK_IEP>,
					 <&cru HCLK_IEP>;
				pm_qos = <&qos_iep>;
				#power-domain-cells = <0>;
			};

			/*
			pd_rga@33 {
				reg = <0x21>;
				clocks = <0x08 0xdc 0x08 0x1e5>;
				pm_qos = <0x63 0x64>;
			};*/
			power-domain@RK3399_PD_RGA {
				reg = <RK3399_PD_RGA>;
				clocks = <&cru ACLK_RGA>,
					 <&cru HCLK_RGA>;
				pm_qos = <&qos_rga_r>,
					 <&qos_rga_w>;
				#power-domain-cells = <0>;
			};

			/*
			pd_vcodec@31 {
				reg = <0x1f>;
				clocks = <0x08 0xeb 0x08 0x1ea>;
				pm_qos = <0x65>;
			};*/
			power-domain@RK3399_PD_VCODEC {
				reg = <RK3399_PD_VCODEC>;
				clocks = <&cru ACLK_VCODEC>,
					 <&cru HCLK_VCODEC>;
				pm_qos = <&qos_video_m0>;
				#power-domain-cells = <0>;
			};

			/*
			pd_vdu@32 {
				reg = <0x20>;
				clocks = <0x08 0xed 0x08 0x1ec>;
				pm_qos = <0x66 0x67>;
			};*/
			power-domain@RK3399_PD_VDU {
				reg = <RK3399_PD_VDU>;
				clocks = <&cru ACLK_VDU>,
					 <&cru HCLK_VDU>;
				pm_qos = <&qos_video_m1_r>,
					 <&qos_video_m1_w>;
				#power-domain-cells = <0>;
			};

			/*
			pd_gpu@35 {
				reg = <0x23>;
				clocks = <0x08 0xd0>;
				pm_qos = <0x68>;
			};*/
			power-domain@RK3399_PD_GPU {
				reg = <RK3399_PD_GPU>;
				clocks = <&cru ACLK_GPU>;
				pm_qos = <&qos_gpu>;
				#power-domain-cells = <0>;
			};

			/*
			pd_edp@25 {
				reg = <0x19>;
				clocks = <0x08 0x16c>;
			};*/
			power-domain@RK3399_PD_EDP {
				reg = <RK3399_PD_EDP>;
				clocks = <&cru PCLK_EDP_CTRL>;
				#power-domain-cells = <0>;
			};

			/*
			pd_emmc@23 {
				reg = <0x17>;
				clocks = <0x08 0xf0>;
				pm_qos = <0x69>;
			};*/
			power-domain@RK3399_PD_EMMC {
				reg = <RK3399_PD_EMMC>;
				clocks = <&cru ACLK_EMMC>;
				pm_qos = <&qos_emmc>;
				#power-domain-cells = <0>;
			};

			/*
			pd_gmac@22 {
				reg = <0x16>;
				clocks = <0x08 0xd5 0x08 0x166>;
				pm_qos = <0x6a>;
			};*/
			power-domain@RK3399_PD_GMAC {
				reg = <RK3399_PD_GMAC>;
				clocks = <&cru ACLK_GMAC>,
					 <&cru PCLK_GMAC>;
				pm_qos = <&qos_gmac>;
				#power-domain-cells = <0>;
			};

			pd_perihp@14 {
				/*reg = <0x0e>;*/
				reg = <RK3399_PD_PERIHP>;
				#address-cells = <0x01>;
				#size-cells = <0x00>;
				clocks = <0x08 0xc0>;
				pm_qos = <0x6b 0x6c 0x6d 0x6e>;

				/*
				pd_sd@27 {
					reg = <0x1b>;
					clocks = <0x08 0x1ce 0x08 0x4c>;
					pm_qos = <0x6f>;
				};*/
				power-domain@RK3399_PD_SD {
					reg = <RK3399_PD_SD>;
					clocks = <&cru HCLK_SDMMC>,
						<&cru SCLK_SDMMC>;
					pm_qos = <&qos_sd>;
					#power-domain-cells = <0>;
				};
			};

			/*
			pd_sdioaudio@28 {
				reg = <0x1c>;
				clocks = <0x08 0x1ee>;
				pm_qos = <0x70>;
			};*/
			power-domain@RK3399_PD_SDIOAUDIO {
				reg = <RK3399_PD_SDIOAUDIO>;
				clocks = <&cru HCLK_SDIO>;
				pm_qos = <&qos_sdioaudio>;
				#power-domain-cells = <0>;
			};

			/*
			pd_usb3@24 {
				reg = <0x18>;
				clocks = <0x08 0xf4>;
				pm_qos = <0x71 0x72>;
			};*/
			power-domain@RK3399_PD_USB3 {
				reg = <RK3399_PD_USB3>;
				clocks = <&cru ACLK_USB3>;
				pm_qos = <&qos_usb_otg0>,
					 <&qos_usb_otg1>;
				#power-domain-cells = <0>;
			};
			
			power-domain@RK3399_PD_VIO {
				/*reg = <0x0f>;*/
				reg = <RK3399_PD_VIO>;
				#power-domain-cells = <1>;
				#address-cells = <1>;
				#size-cells = <0>;

				/*
				pd_hdcp@21 {
					reg = <0x15>;
					clocks = <0x08 0xde 0x08 0x1e7 0x08 0x172>;
					pm_qos = <0x73>;
				};*/
				power-domain@RK3399_PD_HDCP {
					reg = <RK3399_PD_HDCP>;
					clocks = <&cru ACLK_HDCP>,
						 <&cru HCLK_HDCP>,
						 <&cru PCLK_HDCP>;
					pm_qos = <&qos_hdcp>;
					#power-domain-cells = <0>;
				};

				/*
				pd_isp0@19 {
					reg = <0x13>;
					clocks = <0x08 0xe5 0x08 0x1df>;
					pm_qos = <0x74 0x75>;
				};
				*/
				power-domain@RK3399_PD_ISP0 {
					reg = <RK3399_PD_ISP0>;
					clocks = <&cru ACLK_ISP0>,
						 <&cru HCLK_ISP0>;
					pm_qos = <&qos_isp0_m0>,
						 <&qos_isp0_m1>;
					#power-domain-cells = <0>;
				};

				/*
				pd_isp1@20 {
					reg = <0x14>;
					clocks = <0x08 0xe6 0x08 0x1e0>;
					pm_qos = <0x76 0x77>;
				};

				*/
				power-domain@RK3399_PD_ISP1 {
					reg = <RK3399_PD_ISP1>;

					clocks = <&cru ACLK_ISP1>,
						 <&cru HCLK_ISP1>;
					pm_qos = <&qos_isp1_m0>,
						 <&qos_isp1_m1>;
					#power-domain-cells = <0>;
				};

				/*
				pd_tcpc0@RK3399_PD_TCPC0 {
					reg = <0x08>;
					clocks = <0x08 0x7e 0x08 0x7d>;
				};*/
				power-domain@RK3399_PD_TCPC0 {
                    reg = <0x08>;
					clocks = <0x08 0x7e 0x08 0x7d>;
				};

				/*
				pd_tcpc1@RK3399_PD_TCPC1 {
					reg = <0x09>;
					clocks = <0x08 0x80 0x08 0x7f>;
				};*/
				power-domain@RK3399_PD_TCPC1 {
					reg = <0x09>;
					clocks = <&cru 0x80>, <&cru 0x7f>;
				};
				/*
				
				*/
				power-domain@RK3399_PD_VO {
					/*reg = <0x10>;*/
					reg = <RK3399_PD_VO>;
					#power-domain-cells = <1>;
					#address-cells = <1>;
					#size-cells = <0>;

					/*
					pd_vopb@17 {
						reg = <0x11>;
						clocks = <0x08 0xd9 0x08 0x1d9>;
						pm_qos = <0x78 0x79>;
					};
					*/
					power-domain@RK3399_PD_VOPB {
						reg = <RK3399_PD_VOPB>;
						clocks = <&cru ACLK_VOP0>,
							 <&cru HCLK_VOP0>;
						pm_qos = <&qos_vop_big_r>,
							 <&qos_vop_big_w>;
						#power-domain-cells = <0>;
					};

					/*
					pd_vopl@18 {
						reg = <0x12>;
						clocks = <0x08 0xdb 0x08 0x1db>;
						pm_qos = <0x7a>;
					};
					*/
					power-domain@RK3399_PD_VOPL {
						reg = <RK3399_PD_VOPL>;
						clocks = <&cru ACLK_VOP1>,
							 <&cru HCLK_VOP1>;
						pm_qos = <&qos_vop_little>;
						#power-domain-cells = <0>;
					};
				};
			};
		};
/* pmu_io_domains: io-domains { */
	&pmu_io_domains {
		compatible = "rockchip,rk3399-pmu-io-voltage-domain";
		status = "okay";
		pmu1830-supply = <0x7b>;
	};
	/* pmugrf: syscon@ff320000 { */
	&pmugrf {
		compatible = "rockchip,rk3399-pmugrf", "syscon", "simple-mfd";
		reg = <0x00 0xff320000 0x00 0x1000>;
		#address-cells = <0x01>;
		#size-cells = <0x01>;
		phandle = <0x8c>;

		reboot-mode {
			compatible = "syscon-reboot-mode";
			offset = <0x300>;
			mode-bootloader = <0x5242c301>;
			mode-charge = <0x5242c30b>;
			mode-fastboot = <0x5242c309>;
			mode-loader = <0x5242c301>;
			mode-normal = <0x5242c300>;
			mode-recovery = <0x5242c303>;
			mode-ums = <0x5242c30c>;
		};

		pmu-pvtm {
			compatible = "rockchip,rk3399-pmu-pvtm";
			clocks = <0x30 0x07>;
			clock-names = "pmu";
			resets = <0x08 0x1b>;
			reset-names = "pmu";
			status = "disabled";
		};
	};

	/* spi3: spi@ff350000 { */
	&spi3 {
		compatible = "rockchip,rk3399-spi", "rockchip,rk3066-spi";
		reg = <0x00 0xff350000 0x00 0x1000>;
		clocks = <0x30 0x03 0x30 0x1f>;
		clock-names = "spiclk", "apb_pclk";
		interrupts = <0x00 0x3c 0x04 0x00>;
		pinctrl-names = "default";
		pinctrl-0 = <0x7c 0x7d 0x7e 0x7f>;
		#address-cells = <0x01>;
		#size-cells = <0x00>;
		status = "disabled";
	};

	/* uart4: serial@ff370000 { */
	&uart4 {
		compatible = "rockchip,rk3399-uart", "snps,dw-apb-uart";
		reg = <0x00 0xff370000 0x00 0x100>;
		clocks = <0x30 0x06 0x30 0x22>;
		clock-names = "baudclk", "apb_pclk";
		interrupts = <0x00 0x66 0x04 0x00>;
		reg-shift = <0x02>;
		reg-io-width = <0x04>;
		pinctrl-names = "default";
		pinctrl-0 = <0x80>;
		status = "okay";
		assigned-clocks = <0x30 0x0c>;
		assigned-clock-parents = <0x30 0x01>;
	};

	/* i2c4: i2c@ff3d0000 { */
	&i2c4 {
		compatible = "rockchip,rk3399-i2c";
		reg = <0x00 0xff3d0000 0x00 0x1000>;
		clocks = <0x30 0x0a 0x30 0x1c>;
		clock-names = "i2c", "pclk";
		interrupts = <0x00 0x38 0x04 0x00>;
		pinctrl-names = "default";
		pinctrl-0 = <0x81>;
		#address-cells = <0x01>;
		#size-cells = <0x00>;
		status = "okay";
		i2c-scl-rising-time-ns = <0x96>;
		i2c-scl-falling-time-ns = <0x1e>;
		clock-frequency = <0x61a80>;

		fusb30x@22 {
			compatible = "fairchild,fusb302";
			reg = <0x22>;
			pinctrl-names = "default";
			pinctrl-0 = <0x82>;
			int-n-gpios = <0x34 0x17 0x00>;
			vbus-5v-gpios = <0x3c 0x19 0x00>;
			status = "okay";
			phandle = <0x27>;
		};

		gt9xx@14 {
			compatible = "goodix,gt9xx";
			status = "okay";
			reg = <0x14>;
			touch-gpio = <0x3c 0x18 0x08>;
			reset-gpio = <0x3c 0x1e 0x00>;
			max-x = <0x780>;
			max-y = <0x4b0>;
			tp-size = <0x38f>;
			tp-supply = <0x83>;
		};
	};

	/* i2c8: i2c@ff3e0000 { */
	&i2c8 {
		compatible = "rockchip,rk3399-i2c";
		reg = <0x00 0xff3e0000 0x00 0x1000>;
		clocks = <0x30 0x0b 0x30 0x1d>;
		clock-names = "i2c", "pclk";
		interrupts = <0x00 0x3a 0x04 0x00>;
		pinctrl-names = "default";
		pinctrl-0 = <0x84>;
		#address-cells = <0x01>;
		#size-cells = <0x00>;
		status = "disabled";
	};

	/* pcie_phy: pcie-phy { */
	&pcie_phy {
		compatible = "rockchip,rk3399-pcie-phy";
		#phy-cells = <0x00>;
		rockchip,grf = <&grf>;
		clocks = <&cru 0x8a>;
		clock-names = "refclk";
		resets = <&cru 0x87>;
		reset-names = "phy";
		status = "okay";
		phandle = <0x87>;
	};

	/* pcie0: pcie@f8000000 { */
	&pcie0 {
		compatible = "rockchip,rk3399-pcie";
		#address-cells = <0x03>;
		#size-cells = <0x02>;
		aspm-no-l0s;
		clocks = <&cru 0xc5>, <&cru 0xc4>, <&cru 0x147> ,<&cru 0xa0>;
		clock-names = "aclk", "aclk-perf", "hclk", "pm";
		bus-range = <0x00 0x1f>;
		max-link-speed = <0x02>;
		linux,pci-domain = <0x00>;
		msi-map = <0x00 0x85 0x00 0x1000>;
		interrupts = <0x00 0x31 0x04 0x00 0x00 0x32 0x04 0x00 0x00 0x33 0x04 0x00>;
		interrupt-names = "sys", "legacy", "client";
		#interrupt-cells = <0x01>;
		interrupt-map-mask = <0x00 0x00 0x00 0x07>;
		interrupt-map = <0x00 0x00 0x00 0x01 0x86 0x00 0x00 0x00 0x00 0x02 0x86 0x01 0x00 0x00 0x00 0x03 0x86 0x02 0x00 0x00 0x00 0x04 0x86 0x03>;
		phys = <&pcie_phy 0>;
		phy-names = "pcie-phy";
		ranges = <0x83000000 0x00 0xfa000000 0x00 0xfa000000 0x00 0x1e00000 0x81000000 0x00 0xfbe00000 0x00 0xfbe00000 0x00 0x100000>;
		reg = <0x00 0xf8000000 0x00 0x2000000 0x00 0xfd000000 0x00 0x1000000>;
		reg-names = "axi-base", "apb-base";
		resets = <&cru 0x82>, <&cru 0x83>, <&cru 0x84>, <&cru 0x85> ,<&cru 0x86>, <&cru 0x81> ,<&cru 0x80>;
		reset-names = "core", "mgmt", "mgmt-sticky", "pipe", "pm", "pclk", "aclk";
		status = "okay";
		ep-gpios = <0x34 0x00 0x00>;

		
	};

	/* pcie0_intc: interrupt-controller { */
		&pcie0_intc {
			interrupt-controller;
			#address-cells = <0x00>;
			#interrupt-cells = <0x01>;
			phandle = <0x86>;
		};

	/* pwm0: pwm@ff420000 { */
	&pwm0 {
		compatible = "rockchip,rk3399-pwm", "rockchip,rk3288-pwm";
		reg = <0x00 0xff420000 0x00 0x10>;
		#pwm-cells = <0x03>;
		pinctrl-names = "active";
		pinctrl-0 = <0x88>;
		clocks = <0x30 0x1e>;
		clock-names = "pwm";
		status = "okay";
		phandle = <0xd6>;
	};

	/* pwm1: pwm@ff420010 { */
	&pwm1 {
		compatible = "rockchip,rk3399-pwm", "rockchip,rk3288-pwm";
		reg = <0x00 0xff420010 0x00 0x10>;
		#pwm-cells = <0x03>;
		pinctrl-names = "active";
		pinctrl-0 = <0x89>;
		clocks = <0x30 0x1e>;
		clock-names = "pwm";
		status = "okay";
		phandle = <0xe1>;
	};

	/* pwm2: pwm@ff420020 { */
	&pwm2 {
		compatible = "rockchip,rk3399-pwm", "rockchip,rk3288-pwm";
		reg = <0x00 0xff420020 0x00 0x10>;
		#pwm-cells = <0x03>;
		pinctrl-names = "active";
		pinctrl-0 = <0x8a>;
		clocks = <0x30 0x1e>;
		clock-names = "pwm";
		status = "okay";
		phandle = <0xd5>;
	};

	/* pwm3: pwm@ff420030 { */
	&pwm3 {
		compatible = "rockchip,remotectl-pwm";
		reg = <0x00 0xff420030 0x00 0x10>;
		#pwm-cells = <0x03>;
		pinctrl-names = "default";
		pinctrl-0 = <&pwm3a_pin>;
		clocks = <&pmucru 0x1e>;
		clock-names = "pwm";
		status = "okay";
		interrupts = <0x00 0x3d 0x04 0x00>;
		remote_pwm_id = <0x03>;
		handle_cpu_id = <0x01>;

		ir_key1 {
			rockchip,usercode = <0xbf00>;
			rockchip,key_table = <0xff 0x74 0xab 0xa8 0xaa 0xa3 0xae 0xa4 0xfe 0x71 0xfd 0x02 0xfc 0x03 0xfb 0x04 0xfa 0x05 0xf9 0x06 0xf8 0x07 0xf7 0x08 0xf6 0x09 0xf5 0x0a 0xf4 0x0e 0xf3 0x0b 0xf2 0x9e 0xb5 0xe6 0xb4 0xe5 0xb7 0x73 0xb6 0x72 0xec 0x67 0xee 0x69 0xeb 0x6c 0xed 0x6a 0xbd 0xd5 0xbc 0x8e>;
		};

		ir_key2 {
			rockchip,usercode = <0xff00>;
			rockchip,key_table = <0xff 0x74 0xfd 0x71 0xf2 0x6f 0xf6 0x67 0xfb 0x69 0xee 0x6c 0xf9 0x6a 0xf7 0x85 0xfa 0x1c 0xed 0x3b 0xe6 0x1d1 0xef 0x161 0xf3 0x72 0xf1 0x73 0xea 0xcf 0xe9 0xa8 0xf5 0xd0 0xeb 0xa4 0xe7 0xa5 0xe5 0xa3>;
		};

		ir_key3 {
			rockchip,usercode = <0x27d>;
			rockchip,key_table = <0x46 0x74 0x4c 0x71 0xf2 0x6f 0x48 0x67 0x4e 0x69 0x4d 0x6c 0x49 0x6a 0xf7 0x85 0x4a 0x1c 0x42 0x3b 0x18 0x1d1 0xef 0x161 0x5a 0x72 0x0f 0x73 0x17 0xcf 0x57 0xa8 0x16 0xd0 0x54 0xa4 0x1a 0xa5 0x44 0xa3 0x01 0x02 0x02 0x03 0x03 0x04 0x04 0x05 0x05 0x06 0x06 0x07 0x07 0x08 0x08 0x09 0x09 0x0a 0x00 0x0b>;
		};

		ir_key4 {
			rockchip,usercode = <0x7d02>;
			rockchip,key_table = <0xb9 0x74 0xb3 0x71 0xa8 0xa5 0xe9 0xa3 0xe5 0xa8 0xbb 0xd0 0xe8 0xcf 0xab 0xa4 0xb5 0x1c 0xb7 0x67 0xb1 0x69 0xb2 0x6c 0xb6 0x6a 0xf2 0x1d1 0xe7 0x66 0xbd 0x8b 0xa5 0x72 0xf0 0x73 0xfe 0x02 0xfd 0x03 0xfc 0x04 0xfb 0x05 0xfa 0x06 0xf9 0x07 0xf8 0x08 0xf7 0x09 0xf6 0x0a 0xff 0x0b>;
		};

		ir_key5 {
			rockchip,key_table = <0xf0 0x74 0xad 0x66 0xef 0x8b 0xa7 0x71 0xa1 0x161 0xb2 0x67 0xee 0x68 0xa3 0x73 0xa8 0x69 0xa4 0x1c 0xa0 0x6a 0xab 0x72 0xa9 0x0f 0xa5 0x6c 0xed 0x6d 0xac 0x1d1 0xe8 0x02 0xe4 0x03 0xe0 0x04 0xe9 0x05 0xe5 0x06 0xe1 0x07 0xea 0x08 0xe6 0x09 0xe2 0x0a 0xe7 0x0b 0xbb 0x34 0xe3 0x6f 0xaa 0xcf 0xa6 0xa4>;
		};
	};

	/* dfi: dfi@ff630000 { */
	&dfi {
		reg = <0x00 0xff630000 0x00 0x4000>;
		compatible = "rockchip,rk3399-dfi";
		rockchip,pmu = <&pmugrf>;
		clocks = <&cru 0x179>;
		clock-names = "pclk_ddr_mon";
		status = "disabled";
		phandle = <0x8d>;
	};

	&dmc {
		compatible = "rockchip,rk3399-dmc";
		devfreq-events = <&dfi>;
		interrupts = <0x00 0x01 0x04 0x00>;
		clocks = <&cru 0xaa>;
		clock-names = "dmc_clk";
		ddr_timing = <&ddr_timing>;
		upthreshold = <0x28>;
		downdifferential = <0x14>;
		system-status-freq = <0x01 0xc3500 0x08 0x80e80 0x02 0x30d40 0x20 0x493e0 0x10 0x927c0 0x10000 0xc3500 0x2000 0xc3500 0x1000 0x61a80 0xc00 0x927c0 0x4000 0x927c0>;
		auto-min-freq = <0x61a80>;
		auto-freq-en = <0x01>;
		status = "disabled";
		operating-points-v2 = <0x8f>;
		phandle = <0xab>;
	};

	/* vpu: vpu_service@ff650000 { */
	&vpu {
		compatible = "rockchip,vpu_service";
		rockchip,grf = <&grf>;
		iommus = <0x90>;
		iommu_enabled = <0x01>;
		reg = <0x00 0xff650000 0x00 0x800>;
		interrupts = <0x00 0x71 0x04 0x00 0x00 0x72 0x04 0x00>;
		interrupt-names = "irq_dec", "irq_enc";
		clocks = <&cru 0xeb 0x08 0x1ea>;
		clock-names = "aclk_vcodec", "hclk_vcodec";
		resets = <0x08 0x53 0x08 0x51>;
		reset-names = "video_h", "video_a";
		power-domains = <&power RK3399_PD_VCODEC>;
		dev_mode = <0x00>;
		allocator = <0x01>;
		status = "okay";
	};

	/* vpu_mmu: iommu@ff650800 { */
	&vpu_mmu {
		compatible = "rockchip,iommu";
		reg = <0x00 0xff650800 0x00 0x40>;
		interrupts = <0x00 0x73 0x04 0x00>;
		interrupt-names = "vpu_mmu";
		clocks = <&cru 0xeb 0x08 0x1ea>;
		clock-names = "aclk", "hclk";
		power-domains = <&power RK3399_PD_VCODEC>;
		#iommu-cells = <0x00>;
		phandle = <0x90>;
	};

	/* vdec: rkvdec@ff660000 { */
	&vdec {
		compatible = "rockchip,rkvdec";
		rockchip,grf = <&grf>;
		iommus = <0x91>;
		iommu_enabled = <0x01>;
		reg = <0x00 0xff660000 0x00 0x400>;
		interrupts = <0x00 0x74 0x04 0x00>;
		interrupt-names = "irq_dec";
		clocks = <&cru 0xed 0x08 0x1ec 0x08 0x9f 0x08 0x9e>;
		clock-names = "aclk_vcodec", "hclk_vcodec", "clk_cabac", "clk_core";
		resets = <0x08 0x5b 0x08 0x59 0x08 0x5c 0x08 0x5d 0x08 0x58 0x08 0x5a>;
		reset-names = "video_h", "video_a", "video_core", "video_cabac", "niu_a", "0niu_h";
		power-domains = <&power RK3399_PD_VDU>;
		dev_mode = <0x02>;
		allocator = <0x01>;
		status = "okay";
	};

	/* vdec_mmu: iommu@ff660480 { */
	&vdec_mmu {
		compatible = "rockchip,iommu";
		reg = <0x00 0xff660480 0x00 0x40 0x00 0xff6604c0 0x00 0x40>;
		interrupts = <0x00 0x75 0x04 0x00>;
		interrupt-names = "vdec_mmu";
		clocks = <&cru 0xed 0x08 0x1ec>;
		clock-names = "aclk", "hclk";
		power-domains = <&power RK3399_PD_VDU>;
		#iommu-cells = <0x00>;
		phandle = <0x91>;
	};

	
	/* iep_mmu: iommu@ff670800 { */
	&iep_mmu {
		compatible = "rockchip,iommu";
		reg = <0x00 0xff670800 0x00 0x40>;
		interrupts = <0x00 0x2a 0x04 0x00>;
		interrupt-names = "iep_mmu";
		#iommu-cells = <0x00>;
		status = "okay";
		phandle = <0x92>;
	};

	/* rga: rga@ff680000 { */
	&rga {
		compatible = "rockchip,rga2";
		reg = <0x00 0xff680000 0x00 0x1000>;
		interrupts = <0x00 0x37 0x04 0x00>;
		clocks = <&cru 0xdc 0x08 0x1e5 0x08 0x6d>;
		clock-names = "aclk_rga", "hclk_rga", "clk_rga";
		resets = <0x08 0x6a 0x08 0x67 0x08 0x69>;
		reset-names = "core", "axi", "ahb";
		power-domains = <&power RK3399_PD_RGA>;
		status = "okay";
		dev_mode = <0x01>;
		dma-coherent;
	};

	&efuse0 {
		compatible = "rockchip,rk3399-efuse";
		reg = <0x00 0xff690000 0x00 0x80>;
		#address-cells = <0x01>;
		#size-cells = <0x01>;
		clocks = <&cru 0x17d>;
		clock-names = "pclk_efuse";
		status = "disabled";
		specification-serial-number@6 {
			reg = <0x06 0x01>;
			bits = <0x00 0x05>;
			phandle = <0xcf>;
		};

		cpu-id@7 {
			reg = <0x07 0x10>;
			phandle = <0xc5>;
		};

		cpu-leakage@17 {
			reg = <0x17 0x01>;
			phandle = <0xd0>;
		};

		gpu-leakage@18 {
			reg = <0x18 0x01>;
			phandle = <0xd1>;
		};

		center-leakage@19 {
			reg = <0x19 0x01>;
		};

		cpu-leakage@1a {
			reg = <0x1a 0x01>;
			phandle = <0xce>;
		};

		logic-leakage@1b {
			reg = <0x1b 0x01>;
		};

		wafer-info@1c {
			reg = <0x1c 0x01>;
		};
	};

	/* pmucru: pmu-clock-controller@ff750000 { */
	&pmucru {
		compatible = "rockchip,rk3399-pmucru";
		reg = <0x00 0xff750000 0x00 0x1000>;
		#clock-cells = <0x01>;
		#reset-cells = <0x01>;
		assigned-clocks = <0x30 0x01 0x30 0x2c>;
		assigned-clock-rates = <0x284af100 0x5c81a40>;
		phandle = <0x30>;
	};

	/* cru: clock-controller@ff760000 { */
	&cru {
		compatible = "rockchip,rk3399-cru";
		reg = <0x00 0xff760000 0x00 0x1000>;
		#clock-cells = <0x01>;
		#reset-cells = <0x01>;
		assigned-clocks = <&cru 0xc0 0x08 0xc2 0x08 0x1c2 0x08 0x4c 0x08 0xf0 0x08 0xcd 0x08 0x1cd 0x08 0x9f 0x08 0x9e 0x08 0xf4 0x08 0xbe 0x08 0xc9 0x08 0x186 0x08 0xd5 0x08 0x88 0x08 0x87 0x08 0x08 0x08 0x09 0x08 0x06 0x08 0xd0 0x08 0x05 0x08 0xc0 0x08 0x1c0 0x08 0x140 0x08 0xc2 0x08 0x1c1 0x08 0x142 0x08 0x1c2 0x08 0x143 0x08 0x41 0x08 0x42 0x08 0x43 0x08 0x44 0x08 0x45 0x08 0x46 0x08 0x47 0x08 0x48 0x08 0x49 0x08 0x4a 0x08 0x4b 0x08 0xfa 0x08 0xe5 0x08 0xe6 0x08 0x6b 0x08 0x6c 0x08 0x16a 0x08 0xde 0x08 0xe3 0x08 0x1cd 0x08 0x85 0x08 0x86 0x08 0x4e 0x08 0xf0 0x08 0xcd 0x08 0xe1 0x08 0xdc 0x08 0x6d 0x08 0xed 0x08 0xeb 0x08 0x178 0x08 0xd5 0x08 0x9f 0x08 0x9e 0x08 0xf4 0x08 0xbe 0x08 0xc9 0x08 0x186 0x08 0x88 0x08 0x87 0x08 0xd9 0x08 0x1d9 0x08 0xdb 0x08 0x1db>;
		assigned-clock-rates = <0x47868c0 0x2faf080 0x2faf080 0x2faf080 0x2faf080 0x5f5e100 0x2faf080 0x8f0d180 0x8f0d180 0x8f0d180 0x2faf080 0x8f0d180 0x2faf080 0x5f5e100 0x47868c0 0x47868c0 0x30a32c00 0x30a32c00 0x23c34600 0xbebc200 0x2faf0800 0x8f0d180 0x47868c0 0x23c3460 0x11e1a300 0x5f5e100 0x2faf080 0x5f5e100 0x2faf080 0x5f5e100 0x5f5e100 0x5f5e100 0x5f5e100 0x5f5e100 0x5f5e100 0x2faf080 0x2faf080 0x2faf080 0x2faf080 0x2faf080 0xbebc200 0x17d78400 0x17d78400 0x5f5e100 0x5f5e100 0x5f5e100 0x17d78400 0x17d78400 0xbebc200 0x5f5e100 0xbebc200 0xbebc200 0x5f5e100 0x17d78400 0x17d78400 0x17d78400 0x17d78400 0x11e1a300 0x17d78400 0xbebc200 0x17d78400 0x11e1a300 0x11e1a300 0x11e1a300 0x11e1a300 0x11e1a300 0x5f5e100 0x8f0d180 0x8f0d180 0x17d78400 0x5f5e100 0x17d78400 0x5f5e100>;
		phandle = <0x08>;
	};
/* emmc_phy: phy@f780 { */
	&emmc_phy {
		compatible = "rockchip,rk3399-emmc-phy";
		reg = <0xf780 0x24>;
		clocks = <&sdhci>;
		clock-names = "emmcclk";
		#phy-cells = <0>;
		status = "okay";
		phandle = <0x24>;
	};

/* u2phy0_otg: otg-port { */
	&u2phy0_otg {
		//#phy-cells = <0x00>;
		//interrupts = <0x00 0x67 0x04 0x00 0x00 0x68 0x04 0x00 0x00 0x6a 0x04 0x00>;
		//interrupt-names = "otg-bvalid", "otg-id", "linestate";
		status = "okay";
		phandle = <0x28>;
	};

	/* u2phy0_host: host-port { */
	&u2phy0_host {
		//#phy-cells = <0x00>;
		//interrupts = <0x00 0x1b 0x04 0x00>;
		//interrupt-names = "linestate";
		status = "okay";
		phandle = <0x25>;
	};

	/* u2phy0: usb2-phy@e450 { */
		&u2phy0 {
			//compatible = "rockchip,rk3399-usb2phy";
			//reg = <0xe450 0x10>;
			//clocks = <&cru 0x7b>;
			//clock-names = "phyclk";
			//#clock-cells = <0x00>;
			//clock-output-names = "clk_usbphy0_480m";
			status = "okay";
			extcon = <0x27>;

			
		};


	/* grf: syscon@ff770000 { */
	&grf {
		compatible = "rockchip,rk3399-grf", "syscon", "simple-mfd";
		reg = <0x00 0xff770000 0x00 0x10000>;
		#address-cells = <0x01>;
		#size-cells = <0x01>;
		phandle = <0x15>;

		io-domains {
			compatible = "rockchip,rk3399-io-voltage-domain";
			status = "okay";
			bt656-supply = <0x93>;
			audio-supply = <0x94>;
			sdmmc-supply = <0x1f>;
			gpio1830-supply = <0x95>;
		};

		mipi-dphy-rx0 {
			compatible = "rockchip,rk3399-mipi-dphy";
			clocks = <&cru 0x77 0x08 0xa5 0x08 0x16f>;
			clock-names = "dphy-ref", "dphy-cfg", "grf";
			power-domains = <&power RK3399_PD_VIO>;
			status = "disabled";
		};

		pvtm {
			compatible = "rockchip,rk3399-pvtm";
			clocks = <&cru 0x73 0x08 0x74 0x08 0x75 0x08 0x76>;
			clock-names = "core_l", "core_b", "gpu", "ddr";
			resets = <0x08 0x1f 0x08 0x2f 0x08 0x123 0x08 0x4f>;
			reset-names = "core_l", "core_b", "gpu", "ddr";
			status = "okay";
		};
	};

	/* u2phy1: usb2-phy@e460 { */
		&u2phy1 {
			//compatible = "rockchip,rk3399-usb2phy";
			//reg = <0xe460 0x10>;
			//clocks = <&cru 0x7c>;
			//clock-names = "phyclk";
			//#clock-cells = <0x00>;
			//clock-output-names = "clk_usbphy1_480m";
			status = "okay";

			
		};

	/* u2phy1_otg: otg-port { */
		&u2phy1_otg {
			#phy-cells = <0x00>;
			interrupts = <0x00 0x6c 0x04 0x00 0x00 0x6d 0x04 0x00 0x00 0x6f 0x04 0x00>;
			interrupt-names = "otg-bvalid", "otg-id", "linestate";
			status = "okay";
			phandle = <0x2a>;
		};

		/* u2phy1_host: host-port { */
		&u2phy1_host {
			//#phy-cells = <0x00>;
			//interrupts = <0x00 0x1f 0x04 0x00>;
			//interrupt-names = "linestate";
			status = "okay";
			phandle = <0x26>;
		};

	/* tcphy0: phy@ff7c0000 { */
	&tcphy0 {
		compatible = "rockchip,rk3399-typec-phy";
		reg = <0x00 0xff7c0000 0x00 0x40000>;
		rockchip,grf = <&grf>;
		#phy-cells = <0x01>;
		clocks = <&cru 0x7e>, <&cru 0x7d>;
		clock-names = "tcpdcore", "tcpdphy-ref";
		assigned-clocks = <&cru 0x7e>;
		assigned-clock-rates = <50000000>;
		power-domains = <&power 0x08>;
		resets = <&cru 0x95>, <&cru 0x94>, <&cru 0x14c>;
		reset-names = "uphy", "uphy-pipe", "uphy-tcphy";
		rockchip,typec-conn-dir = <0xe580 0x00 0x10>;
		rockchip,usb3tousb2-en = <0xe580 0x03 0x13>;
		rockchip,usb3-host-disable = <0x2434 0x00 0x10>;
		rockchip,usb3-host-port = <0x2434 0x0c 0x1c>;
		rockchip,external-psm = <0xe588 0x0e 0x1e>;
		rockchip,pipe-status = <0xe5c0 0x00 0x00>;
		rockchip,uphy-dp-sel = <0x6268 0x13 0x13>;
		status = "okay";
		extcon = <0x27>;

		
	};

	/* tcphy0_dp: dp-port { */
		&tcphy0_dp {
			#phy-cells = <0x00>;
			phandle = <0x2c>;
		};

		/* tcphy0_usb3: usb3-port { */
		&tcphy0_usb3 {
			#phy-cells = <0x00>;
			phandle = <0x29>;
		};

	/* tcphy1: phy@ff800000 { */
	&tcphy1 {
		compatible = "rockchip,rk3399-typec-phy";
		reg = <0x00 0xff800000 0x00 0x40000>;
		rockchip,grf = <&grf>;
		#phy-cells = <0x01>;
		clocks = <&cru 0x80>, <&cru 0x7f>;
		clock-names = "tcpdcore", "tcpdphy-ref";
		assigned-clocks = <&cru 0x80>;
		assigned-clock-rates = <50000000>;
		power-domains = <&power 0x09>;
		resets = <&cru 0x9d>, <&cru 0x9c>, <&cru 0x14d>;
		reset-names = "uphy", "uphy-pipe", "uphy-tcphy";
		rockchip,typec-conn-dir = <0xe58c 0x00 0x10>;
		rockchip,usb3tousb2-en = <0xe58c 0x03 0x13>;
		rockchip,usb3-host-disable = <0x2444 0x00 0x10>;
		rockchip,usb3-host-port = <0x2444 0x0c 0x1c>;
		rockchip,external-psm = <0xe594 0x0e 0x1e>;
		rockchip,pipe-status = <0xe5c0 0x10 0x10>;
		rockchip,uphy-dp-sel = <0x6268 0x03 0x13>;
		status = "okay";

		
	};

	/* tcphy1_dp: dp-port { */
		&tcphy1_dp {
			#phy-cells = <0x00>;
			phandle = <0x2d>;
		};

		/* tcphy1_usb3: usb3-port { */
		&tcphy1_usb3 {
			#phy-cells = <0x00>;
			phandle = <0x2b>;
		};
	
	/* rktimer: rktimer@ff850000 { */
	&rktimer {
		compatible = "rockchip,rk3399-timer";
		reg = <0x00 0xff850000 0x00 0x1000>;
		interrupts = <GIC_SPI 81 IRQ_TYPE_LEVEL_HIGH 0>;
		/*clocks = <&cru 0x168 0x08 0x5a>;*/

		clocks = <&cru PCLK_TIMER0>, <&cru SCLK_TIMER00>;
		clock-names = "pclk", "timer";
	};

	/* spdif: spdif@ff870000 { */
	&spdif {
		compatible = "rockchip,rk3399-spdif";
		reg = <0x00 0xff870000 0x00 0x1000>;
		interrupts = <0x00 0x42 0x04 0x00>;
		dmas = <0x97 0x07>;
		dma-names = "tx";
		clock-names = "mclk", "hclk";
		clocks = <&cru 0x55 0x08 0x1d7>;
		pinctrl-names = "default";
		pinctrl-0 = <0x98>;
		power-domains = <&power RK3399_PD_SDIOAUDIO>;
		status = "disabled";
		assigned-clocks = <&cru 0xb1>;
		assigned-clock-parents = <0x08 0x05>;
	};

	/* i2s0: i2s@ff880000 { */
	&i2s0 {
		compatible = "rockchip,rk3399-i2s", "rockchip,rk3066-i2s";
		reg = <0x00 0xff880000 0x00 0x1000>;
		rockchip,grf = <&grf>;
		interrupts = <0x00 0x27 0x04 0x00>;
		dmas = <0x97 0x00 0x97 0x01>;
		dma-names = "tx", "rx";
		clock-names = "i2s_clk", "i2s_hclk";
		clocks = <&cru 0x56 0x08 0x1d4>;
		pinctrl-names = "default";
		pinctrl-0 = <0x99>;
		power-domains = <&power RK3399_PD_SDIOAUDIO>;
		status = "okay";
		assigned-clocks = <&cru 0xae>;
		assigned-clock-parents = <0x08 0x05>;
		rockchip,i2s-broken-burst-len;
		rockchip,playback-channels = <0x08>;
		rockchip,capture-channels = <0x08>;
		#sound-dai-cells = <0x00>;
		phandle = <0xd7>;
	};

	/* i2s1: i2s@ff890000 { */
	&i2s1 {
		compatible = "rockchip,rk3399-i2s", "rockchip,rk3066-i2s";
		reg = <0x00 0xff890000 0x00 0x1000>;
		interrupts = <0x00 0x28 0x04 0x00>;
		dmas = <0x97 0x02 0x97 0x03>;
		dma-names = "tx", "rx";
		clock-names = "i2s_clk", "i2s_hclk";
		clocks = <&cru 0x57 0x08 0x1d5>;
		pinctrl-names = "default";
		pinctrl-0 = <0x9a>;
		power-domains = <&power RK3399_PD_SDIOAUDIO>;
		status = "okay";
		assigned-clocks = <&cru 0xaf>;
		assigned-clock-parents = <0x08 0x05>;
		#sound-dai-cells = <0x00>;
		phandle = <0xd9>;
	};

	/* i2s2: i2s@ff8a0000 { */
	&i2s2 {
		compatible = "rockchip,rk3399-i2s", "rockchip,rk3066-i2s";
		reg = <0x00 0xff8a0000 0x00 0x1000>;
		interrupts = <0x00 0x29 0x04 0x00>;
		dmas = <0x97 0x04 0x97 0x05>;
		dma-names = "tx", "rx";
		clock-names = "i2s_clk", "i2s_hclk";
		clocks = <&cru 0x58 0x08 0x1d6>;
		power-domains = <&power RK3399_PD_SDIOAUDIO>;
		status = "okay";
		assigned-clocks = <&cru 0xb0>;
		assigned-clock-parents = <0x08 0x05>;
		#sound-dai-cells = <0x00>;
		rockchip,bclk-fs = <0x80>;
		phandle = <0xcb>;
	};

	/* gpu: gpu@ff9a0000 { */
	&gpu {
		compatible = "arm,malit860", "arm,malit86x", "arm,malit8xx", "arm,mali-midgard";
		reg = <0x00 0xff9a0000 0x00 0x10000>;
		interrupts = <0x00 0x13 0x04 0x00 0x00 0x14 0x04 0x00 0x00 0x15 0x04 0x00>;
		interrupt-names = "GPU", "JOB", "MMU";
		clocks = <&cru 0xd0>;
		clock-names = "clk_mali";
		#cooling-cells = <0x02>;
		power-domains = <&power RK3399_PD_GPU>;
		power-off-delay-ms = <0xc8>;
		status = "okay";
		operating-points-v2 = <0x9b>;
		mali-supply = <0x9c>;
		phandle = <0x5f>;

		power_model {
			compatible = "arm,mali-simple-power-model";
			voltage = <0x384>;
			frequency = <0x1f4>;
			static-power = <0x12c>;
			dynamic-power = <0x18c>;
			ts = <0x7d00 0x125c 0xffffffb0 0x02>;
			thermal-zone = "gpu-thermal";
		};
	};

	/* vopl: vop@ff8f0000 { */
	&vopl {
		compatible = "rockchip,rk3399-vop-lit";
		reg = <0x00 0xff8f0000 0x00 0x600 0x00 0xff8f1c00 0x00 0x200 0x00 0xff8f2000 0x00 0x400>;
		reg-names = "regs", "cabc_lut", "gamma_lut";
		interrupts = <0x00 0x77 0x04 0x00>;
		clocks = <&cru 0xdb 0x08 0xb5 0x08 0x1db 0x08 0xb7>;
		clock-names = "aclk_vop", "dclk_vop", "hclk_vop", "dclk_source";
		resets = <0x08 0x113 0x08 0x117 0x08 0x119>;
		reset-names = "axi", "ahb", "dclk";
		power-domains = <&power RK3399_PD_VOPL>;
		iommus = <0x9d>;
		status = "okay";
		assigned-clocks = <&cru 0xb7>;
		assigned-clock-parents = <0x08 0x07>;


		
	};

	/* vopl_out: port { */
		&vopl_out {
			//#address-cells = <0x01>;
			//#size-cells = <0x00>;
			phandle = <0xbd>;

			
		};
	/* vopl_out_mipi: endpoint@0 { */
		&vopl_out_mipi {
			reg = <0x00>;
			//remote-endpoint = <&mipi_in_vopl>;
			phandle = <0xb2>;
		};

		/* vopl_out_edp: endpoint@1 { */
		&vopl_out_edp {
			reg = <0x01>;
			//remote-endpoint = <&edp_in_vopl>;
			phandle = <0xba>;
		};

		/* vopl_out_hdmi: endpoint@2 { */
		&vopl_out_hdmi {
			reg = <0x02>;
			//remote-endpoint = <&hdmi_in_vopl>;
			phandle = <0xb0>;
		};

		/* vopl_out_dp: endpoint@3 { */
		&vopl_out_dp {
			reg = <0x03>;
			//remote-endpoint = <&dp_in_vopl>;
			phandle = <0x2f>;
		};

		/* vopl_out_mipi1: endpoint@4 { */
		&vopl_out_mipi1 {
			reg = <0x04>;
			//remote-endpoint = <&mipi1_in_vopl>;
			phandle = <0xb7>;
		};
	/* vopl_mmu: iommu@ff8f3f00 { */
	&vopl_mmu {
		compatible = "rockchip,iommu";
		reg = <0x00 0xff8f3f00 0x00 0x100>;
		interrupts = <0x00 0x77 0x04 0x00>;
		interrupt-names = "vopl_mmu";
		clocks = <&cru 0xdb>,<&cru 0x1db>;
		clock-names = "aclk", "hclk";
		power-domains = <&power RK3399_PD_VOPL>;
		#iommu-cells = <0x00>;
		status = "okay";
		phandle = <0x9d>;
	};

	/* vopb: vop@ff900000 { */
	&vopb {
		//compatible = "rockchip,rk3399-vop-big";
		reg = <0x00 0xff900000 0x00 0x600 0x00 0xff901c00 0x00 0x200 0x00 0xff902000 0x00 0x1000>;
		reg-names = "regs", "cabc_lut", "gamma_lut";
		interrupts = <0x00 0x76 0x04 0x00>;
		clocks = <&cru 0xd9>, <&cru 0xb4>, <&cru 0x1d9>, <&cru 0xb6>;
		clock-names = "aclk_vop", "dclk_vop", "hclk_vop", "dclk_source";
		//resets = <0x08 0x112 0x08 0x116 0x08 0x118>;
		//reset-names = "axi", "ahb", "dclk";
		//power-domains = <&power RK3399_PD_VOPB>;
		//iommus = <0xa4>;
		status = "okay";
		assigned-clocks = <&cru 0xb6>;
		assigned-clock-parents = <&cru 0x04>;


		
	};

	/* vopb_out: port { */
		&vopb_out {
			//#address-cells = <0x01>;
			//#size-cells = <0x00>;
			phandle = <0xbc>;

			
		};
	/* vopb_out_edp: endpoint@0 { */
		&vopb_out_edp {
			reg = <0x00>;
			//remote-endpoint = <&edp_in_vopb>;
			phandle = <0xb9>;
		};

		/* vopb_out_mipi: endpoint@1 { */
		&vopb_out_mipi {
			reg = <0x01>;
			//remote-endpoint = <&mipi_in_vopb>;
			phandle = <0xb1>;
		};

		/* vopb_out_hdmi: endpoint@2 { */
		&vopb_out_hdmi {
			reg = <0x02>;
			//remote-endpoint = <&hdmi_in_vopb>;
			phandle = <0xaf>;
		};

		/* vopb_out_dp: endpoint@3 { */
		&vopb_out_dp {
			reg = <0x03>;
			//remote-endpoint = <&dp_in_vopb>;
			phandle = <0x2e>;
		};

		/* vopb_out_mipi1: endpoint@4 { */
		&vopb_out_mipi1 {
			reg = <0x04>;
			//remote-endpoint = <&mipi1_in_vopb>;
			phandle = <0xb6>;
		};

	/* vopb_mmu: iommu@ff903f00 { */
	&vopb_mmu {
		//compatible = "rockchip,iommu";
		//reg = <0x00 0xff903f00 0x00 0x100>;
		//interrupts = <0x00 0x76 0x04 0x00>;
		//interrupt-names = "vopb_mmu";
		//clocks = <&cru 0xd9 0x08 0x1d9>;
		clock-names = "aclk", "hclk";
		//power-domains = <&power RK3399_PD_VOPB>;
		//#iommu-cells = <0x00>;
		status = "okay";
		phandle = <0xa4>;
	};

	
	/* isp0_mmu: iommu@ff914000 { */
	&isp0_mmu {
		//compatible = "rockchip,iommu";
		//reg = <0x00 0xff914000 0x00 0x100 0x00 0xff915000 0x00 0x100>;
		//interrupts = <0x00 0x2b 0x04 0x00>;
		//interrupt-names = "isp0_mmu";
		//#iommu-cells = <0x00>;
		//clocks = <&cru 0xe7 0x08 0x1e1>;
		clock-names = "aclk", "hclk";
		//power-domains = <&power RK3399_PD_ISP0>;
		//rk_iommu,disable_reset_quirk;
		status = "okay";
		phandle = <0xac>;
	};
	
	/* isp1_mmu: iommu@ff924000 { */
	isp1_mmu {
		//compatible = "rockchip,iommu";
		//reg = <0x00 0xff924000 0x00 0x100 0x00 0xff925000 0x00 0x100>;
		//interrupts = <0x00 0x2c 0x04 0x00>;
		//interrupt-names = "isp1_mmu";
		//#iommu-cells = <0x00>;
		//clocks = <&cru 0xe8 0x08 0x1e2>;
		clock-names = "aclk", "hclk";
		//power-domains = <&power RK3399_PD_ISP1>;
		rk_iommu,disable_reset_quirk;
		status = "okay";
		phandle = <0xad>;
	};

	/* hdmi: hdmi@ff940000 { */
	&hdmi {
		//compatible = "rockchip,rk3399-dw-hdmi";
		//reg = <0x00 0xff940000 0x00 0x20000>;
		//reg-io-width = <0x04>;
		//rockchip,grf = <&grf>;
		//pinctrl-names = "default";
		//pinctrl-0 = <0xae>;
		//power-domains = <&power RK3399_PD_HDCP>;
		interrupts = <0x00 0x17 0x04 0x00>;
		//clocks = <&cru 0x174 0x08 0x71 0x08 0x07 0x08 0x16f 0x08 0x70>;
		//clock-names = "iahb", "isfr", "vpll", "grf", "cec";
		status = "okay";
		#address-cells = <0x01>;
		#size-cells = <0x00>;
		//#sound-dai-cells = <0x00>;
		ddc-i2c-scl-high-time-ns = <0x2599>;
		ddc-i2c-scl-low-time-ns = <0x2710>;
		phandle = <0xcc>;
	};

	/* hdmi_in_vopb: endpoint@0 { */
		&hdmi_in_vopb {
			//reg = <0x00>;
			//remote-endpoint = <&vopb_out_hdmi>;
			status = "disabled";
			phandle = <0xa7>;
		};

		/* hdmi_in_vopl: endpoint@1 { */
		&hdmi_in_vopl {
			//reg = <0x01>;
			//remote-endpoint = <&vopl_out_hdmi>;
			status = "okay";
			phandle = <0xa0>;
		};

		/* mipi_in_vopb: endpoint@0 { */
			&mipi_in_vopb {
				//reg = <0x00>;
				//remote-endpoint = <&vopb_out_mipi>;
				status = "okay";
				phandle = <0xa6>;
			};

			/* mipi_in_vopl: endpoint@1 { */
			&mipi_in_vopl {
				//reg = <0x01>;
				//remote-endpoint = <&vopl_out_mipi>;
				status = "disabled";
				phandle = <0x9e>;
			};
	/* mipi_dsi: dsi@ff960000 { */
	&mipi_dsi {
		//compatible = "rockchip,rk3399-mipi-dsi";
		//reg = <0x00 0xff960000 0x00 0x8000>;
		//interrupts = <0x00 0x2d 0x04 0x00>;
		//clocks = <&cru 0xa2 0x08 0x170 0x08 0xa3>;
		clock-names = "ref", "pclk", "phy_cfg";
		//resets = <0x08 0xfb>;
		//reset-names = "apb";
		//power-domains = <&power RK3399_PD_VIO>;
		//rockchip,grf = <&grf>;
		//#address-cells = <0x01>;
		//#size-cells = <0x00>;
		status = "disabled";
		reset-dsi = <0x3b 0x0c 0x01>;
		enable-dsi = <0x34 0x12 0x00>;
		rockchip,lane-rate = <0x134>;

		panel@0 {
			compatible = "simple-panel-dsi";
			reg = <0x00>;
			backlight = <0xb3>;
			power-supply = <0xb4>;
			enable-gpios = <0x3c 0x1a 0x00>;
			dsi,flags = <0xa03>;
			dsi,format = <0x00>;
			bus-format = <0x100a>;
			dsi,lanes = <0x04>;
			prepare-delay-ms = <0x14>;
			unprepare-delay-ms = <0x14>;
			enable-delay-ms = <0x14>;
			disable-delay-ms = <0x14>;
			init-delay-ms = <0x14>;
			reset-delay-ms = <0x14>;
			status = "okay";
			panel-init-sequence = [29 02 06 3c 01 03 00 02 00 29 02 06 14 01 02 00 00 00 29 02 06 64 01 02 00 00 00 29 02 06 68 01 02 00 00 00 29 02 06 6c 01 02 00 00 00 29 02 06 70 01 02 00 00 00 29 02 06 34 01 1f 00 00 00 29 02 06 10 02 1f 00 00 00 29 02 06 04 01 01 00 00 00 29 02 06 04 02 01 00 00 00 29 02 06 50 04 00 01 f0 03 29 02 06 54 04 28 00 8c 00 29 02 06 58 04 00 04 8c 00 29 02 06 5c 04 05 00 0f 00 29 02 06 60 04 58 02 0f 00 29 02 06 64 04 01 00 00 00 29 02 06 a0 04 2d 80 44 00 29 02 06 a0 04 2d 80 04 00 29 02 06 04 05 04 00 00 00 29 02 06 80 04 00 01 02 03 29 02 06 84 04 04 07 05 08 29 02 06 88 04 09 0a 0e 0f 29 02 06 8c 04 0b 0c 0d 10 29 02 06 90 04 16 17 11 12 29 02 06 94 04 13 14 15 1b 29 02 06 98 04 18 19 1a 06 29 02 06 9c 04 31 00 00 00];
			panel-exit-sequence = <0x5050128 0x5780110>;

			display-timings {
				native-mode = <0xb5>;

				timing0 {
					clock-frequency = <0x30d4000>;
					hactive = <0x400>;
					vactive = <0x258>;
					hsync-len = <0x28>;
					hback-porch = <0x8c>;
					hfront-porch = <0x8c>;
					vsync-len = <0x05>;
					vback-porch = <0x0f>;
					vfront-porch = <0x0f>;
					hsync-active = <0x00>;
					vsync-active = <0x00>;
					de-active = <0x00>;
					pixelclk-active = <0x00>;
					phandle = <0xb5>;
				};
			};
		};
	};

	/* mipi1_in_vopb: endpoint@0 { */
		&mipi1_in_vopb {
			//reg = <0x00>;
			//remote-endpoint = <&vopb_out_mipi1>;
			phandle = <0xa9>;
		};

		/* mipi1_in_vopl: endpoint@1 { */
		&mipi1_in_vopl {
			//reg = <0x01>;
			//remote-endpoint = <&vopl_out_mipi1>;
			phandle = <0xa2>;
		};

	/* mipi_dsi1: dsi@ff968000 { */
	&mipi_dsi1 {
		//compatible = "rockchip,rk3399-mipi-dsi";
		//reg = <0x00 0xff968000 0x00 0x8000>;
		//interrupts = <0x00 0x2e 0x04 0x00>;
		//clocks = <&cru 0xa2 0x08 0x171 0x08 0xa4>;
		//clock-names = "ref", "pclk", "phy_cfg";
		//resets = <0x08 0xfc>;
		//reset-names = "apb";
		//power-domains = <&power RK3399_PD_VIO>;
		//rockchip,grf = <&grf>;
		//#address-cells = <0x01>;
		//#size-cells = <0x00>;
		status = "disabled";
	};

	/* edp_in_vopb: endpoint@0 { */
		&edp_in_vopb{
			//reg = <0x00>;
			//remote-endpoint = <&vopb_out_edp>;
			status = "disabled";
			phandle = <0xa5>;
		};

		/* edp_in_vopl: endpoint@1 { */
		&edp_in_vopl {	
			//reg = <0x01>;
			//remote-endpoint = <&vopl_out_edp>;
			status = "disabled";
			phandle = <0x9f>;
		};
	/* edp: edp@ff970000 { */
	&edp {
		//compatible = "rockchip,rk3399-edp";
		//reg = <0x00 0xff970000 0x00 0x8000>;
		//interrupts = <0x00 0x0a 0x04 0x00>;
		//clocks = <&cru 0x16a 0x08 0x16c>;
		//clock-names = "dp", "pclk";
		//power-domains = <&power RK3399_PD_EDP>;
		//resets = <0x08 0x11d>;
		//reset-names = "dp";
		//rockchip,grf = <&grf>;
		status = "disabled";
		//pinctrl-names = "default";
		//pinctrl-0 = <0xb8>;
		force-hpd;

		ports {
			#address-cells = <0x01>;
			#size-cells = <0x00>;

			port@1 {
				reg = <0x01>;
				#address-cells = <0x01>;
				#size-cells = <0x00>;

				endpoint@0 {
					reg = <0x00>;
					remote-endpoint = <0xbb>;
					phandle = <0xd2>;
				};
			};
		};
	};

	/* gpio0: gpio0@ff720000 { */
		&gpio0 {
			//compatible = "rockchip,gpio-bank";
			//reg = <0x00 0xff720000 0x00 0x100>;
			//clocks = <0x30 0x17>;
			//interrupts = <0x00 0x0e 0x04 0x00>;
			//gpio-controller;
			//#gpio-cells = <0x02>;
			//interrupt-controller;
			//#interrupt-cells = <0x02>;
			phandle = <0x3b>;
		};

		/* gpio1: gpio1@ff730000 { */
		&gpio1 {
			//compatible = "rockchip,gpio-bank";
			//reg = <0x00 0xff730000 0x00 0x100>;
			//clocks = <0x30 0x18>;
			//interrupts = <0x00 0x0f 0x04 0x00>;
			//gpio-controller;
			//#gpio-cells = <0x02>;
			//interrupt-controller;
			//#interrupt-cells = <0x02>;
			phandle = <0x34>;
		};

		/* gpio2: gpio2@ff780000 { */
			&gpio2 {
				//compatible = "rockchip,gpio-bank";
				//reg = <0x00 0xff780000 0x00 0x100>;
				//clocks = <&cru 0x150>;
				//interrupts = <0x00 0x10 0x04 0x00>;
				//gpio-controller;
				//#gpio-cells = <0x02>;
				//interrupt-controller;
				//#interrupt-cells = <0x02>;
				phandle = <0xdd>;
			};
	
			/* gpio3: gpio3@ff788000 { */
			&gpio3 {
				//compatible = "rockchip,gpio-bank";
				//reg = <0x00 0xff788000 0x00 0x100>;
				//clocks = <&cru 0x151>;
				//interrupts = <0x00 0x11 0x04 0x00>;
				//gpio-controller;
				//#gpio-cells = <0x02>;
				//interrupt-controller;
				//#interrupt-cells = <0x02>;
				phandle = <0x18>;
			};
	
			/* gpio4: gpio4@ff790000 { */
			&gpio4 {
				//compatible = "rockchip,gpio-bank";
				//reg = <0x00 0xff790000 0x00 0x100>;
				//clocks = <&cru 0x152>;
				//interrupts = <0x00 0x12 0x04 0x00>;
				//gpio-controller;
				//#gpio-cells = <0x02>;
				//interrupt-controller;
				//#interrupt-cells = <0x02>;
				phandle = <0x3c>;
			};

			
		&pcfg_pull_up {
			//bias-pull-up;
			phandle = <0xc0>;
		};

		&pcfg_pull_down {
			//bias-pull-down;
			phandle = <0xc4>;
		};

		&pcfg_pull_none {
			//bias-disable;
			phandle = <0xc2>;
		};

		&pcfg_pull_up_20ma {
			//bias-pull-up;
			drive-strength = <20>;
		};

		&pcfg_pull_none_20ma {
			//bias-disable;
			drive-strength = <20>;
		};

		&pcfg_pull_none_18ma {
			//bias-disable;
			drive-strength = <0x12>;
		};

		&pcfg_pull_none_12ma {
			//bias-disable;
			//drive-strength = <0x0c>;
			phandle = <0xc3>;
		};

		&pcfg_pull_up_8ma {
			//bias-pull-up;
			//drive-strength = <0x08>;
		};

		&pcfg_pull_down_4ma {
			//bias-pull-down;
			//drive-strength = <0x04>;
		};

		&pcfg_pull_up_2ma {
			//bias-pull-up;
			//drive-strength = <0x02>;
		};

		&pcfg_pull_down_12ma {
			//bias-pull-down;
			//drive-strength = <0x0c>;
		};

		&pcfg_pull_none_13ma {
			//bias-disable;
			//drive-strength = <0x0d>;
			phandle = <0xc1>;
		};

		&pcfg_output_high {
			output-high;
		};

		&pcfg_output_low {
			output-low;
		};

		/* rgmii_pins: rgmii-pins { */
			&rgmii_pins {
				
				rockchip,pins = <0x03 0x11 0x01 0xc1 0x03 0x0e 0x01 0xc2 0x03 0x0d 0x01 0xc2 0x03 0x0c 0x01 0xc1 0x03 0x0b 0x01 0xc2 0x03 0x09 0x01 0xc2 0x03 0x08 0x01 0xc2 0x03 0x07 0x01 0xc2 0x03 0x06 0x01 0xc2 0x03 0x05 0x01 0xc1 0x03 0x04 0x01 0xc1 0x03 0x03 0x01 0xc2 0x03 0x02 0x01 0xc2 0x03 0x01 0x01 0xc1 0x03 0x00 0x01 0xc1>;
				
				phandle = <0x1a>;
			};

			&rmii-pins {

				rockchip,pins = <0x03 0x0d 0x01 0xc2 0x03 0x0c 0x01 0xc1 0x03 0x0b 0x01 0xc2 0x03 0x0a 0x01 0xc2 0x03 0x09 0x01 0xc2 0x03 0x08 0x01 0xc2 0x03 0x07 0x01 0xc2 0x03 0x06 0x01 0xc2 0x03 0x05 0x01 0xc1 0x03 0x04 0x01 0xc1>;
			
			};

			/* i2c0_xfer: i2c0-xfer { */
				&i2c0_xfer {
					rockchip,pins = <0x01 0x0f 0x02 0xc2 0x01 0x10 0x02 0xc2>;
					phandle = <0x31>;
				};

				/* i2c1_xfer: i2c1-xfer { */
			&i2c1_xfer {
				rockchip,pins = <0x04 0x02 0x01 0xc2 0x04 0x01 0x01 0xc2>;
				phandle = <0x39>;
			};

			/* i2c2_xfer: i2c2-xfer { */
				&i2c2_xfer {
					rockchip,pins = <0x02 0x01 0x02 0xc3 0x02 0x00 0x02 0xc3>;
					phandle = <0x3d>;
				};

				/* i2c3_xfer: i2c3-xfer { */
			&i2c3_xfer {
				rockchip,pins = <0x04 0x11 0x01 0xc2 0x04 0x10 0x01 0xc2>;
				phandle = <0x3e>;
			};
			/* i2c4_xfer: i2c4-xfer { */
				&i2c4_xfer {
					rockchip,pins = <0x01 0x0c 0x01 0xc2 0x01 0x0b 0x01 0xc2>;
					phandle = <0x81>;
				};
				/* i2c5_xfer: i2c5-xfer { */
			&i2c5_xfer {
				rockchip,pins = <0x03 0x0b 0x02 0xc2 0x03 0x0a 0x02 0xc2>;
				phandle = <0x3f>;
			};
			/* i2c6_xfer: i2c6-xfer { */
				&i2c6_xfer {
					rockchip,pins = <0x02 0x0a 0x02 0xc2 0x02 0x09 0x02 0xc2>;
					phandle = <0x40>;
				};

				/* i2c7_xfer: i2c7-xfer { */
			&i2c7_xfer {

				rockchip,pins = <0x02 0x08 0x02 0xc2 0x02 0x07 0x02 0xc2>;
				phandle = <0x41>;
			};
			/* i2c8_xfer: i2c8-xfer { */
				&i2c8_xfer {
					rockchip,pins = <0x01 0x15 0x01 0xc2 0x01 0x14 0x01 0xc2>;
					phandle = <0x84>;
				};

				/* i2s0_8ch_bus: i2s0-8ch-bus { */
			&i2s0_8ch_bus {
				rockchip,pins = 
					<3 RK_PD0 1 &pcfg_pull_none>,
					<3 RK_PD1 1 &pcfg_pull_none>,
					<3 RK_PD2 1 &pcfg_pull_none>,
					<3 RK_PD3 1 &pcfg_pull_none>,
					<3 RK_PD4 1 &pcfg_pull_none>,
					<3 RK_PD5 1 &pcfg_pull_none>,
					<3 RK_PD6 1 &pcfg_pull_none>,
					<3 RK_PD7 1 &pcfg_pull_none>,
					<4 RK_PA0 1 &pcfg_pull_none>;
				phandle = <0x99>;
			};

			/* i2s1_2ch_bus: i2s1-2ch-bus { */
				&i2s1_2ch_bus {
					rockchip,pins = 
						<4 RK_PA3 1 &pcfg_pull_none>,
						<4 RK_PA4 1 &pcfg_pull_none>,
						<4 RK_PA5 1 &pcfg_pull_none>,
						<4 RK_PA6 1 &pcfg_pull_none>,
						<4 RK_PA7 1 &pcfg_pull_none>;
					phandle = <0x9a>;
				};
				
			/* sdio0_bus1: sdio0-bus1 { */
			&sdio0_bus1 {
				rockchip,pins = <2 RK_PC4 1 &pcfg_pull_up>;
			};

			/* sdio0_bus4: sdio0-bus4 { */
			&sdio0_bus4 {
				rockchip,pins = 
					<2 RK_PC4 1 &pcfg_pull_up>,
					<2 RK_PC5 1 &pcfg_pull_up>,
					<2 RK_PC6 1 &pcfg_pull_up>,
					<2 RK_PC7 1 &pcfg_pull_up>;
				phandle = <0x1c>;
			};

			/* sdio0_cmd: sdio0-cmd { */
			&sdio0_cmd {
				rockchip,pins = <2 RK_PD0 1 &pcfg_pull_up>;
				phandle = <0x1d>;
			};

			/* sdio0_clk: sdio0-clk { */
			&sdio0_clk {
				rockchip,pins = <2 RK_PD1 1 &pcfg_pull_none>;
				phandle = <0x1e>;
			};

			/* sdio0_cd: sdio0-cd { */
			&sdio0_cd {
				rockchip,pins = <2 RK_PD2 1 &pcfg_pull_up>;
			};

			/* sdio0_pwr: sdio0-pwr { */
			&sdio0_pwr {	
				rockchip,pins = <2 RK_PD3 1 &pcfg_pull_up>;
			};

			/* sdio0_bkpwr: sdio0-bkpwr { */
			&sdio0_bkpwr {
				rockchip,pins = <2 RK_PD3 1 &pcfg_pull_up>;
			};

			/* sdio0_wp: sdio0-wp { */
			&sdio0_wp {
				rockchip,pins = <0 RK_PA3 1 &pcfg_pull_up>;
			};

			/* sdio0_int: sdio0-int { */
			&sdio0_int {
				rockchip,pins = <0 RK_PA4 1 &pcfg_pull_up>;
			};

			
			/* sdmmc_bus1: sdmmc-bus1 { */
				&sdmmc_bus1 {
					rockchip,pins = <4 RK_PB0 1 &pcfg_pull_up>;
				};
	
				/* sdmmc_bus4: sdmmc-bus4 { */
				&sdmmc_bus4 {
					rockchip,pins = 
						<4 RK_PB0 1 &pcfg_pull_up>,
						<4 RK_PB1 1 &pcfg_pull_up>,
						<4 RK_PB2 1 &pcfg_pull_up>,
						<4 RK_PB3 1 &pcfg_pull_up>;
					phandle = <0x23>;
				};
	
				/* sdmmc_clk: sdmmc-clk { */
				&sdmmc_clk {
					rockchip,pins = <4 RK_PB4 1 &pcfg_pull_none>;
					phandle = <0x20>;
				};
	
				/* sdmmc_cmd: sdmmc-cmd { */
				&sdmmc_cmd {
					rockchip,pins = <4 RK_PB5 1 &pcfg_pull_up>;
					phandle = <0x21>;
				};
	
				/* sdmmc_cd: sdmcc-cd { */
				&sdmmc_cd {
					rockchip,pins = <0 RK_PA7 1 &pcfg_pull_up>;
					phandle = <0x22>;
				};
	
				/* sdmmc_wp: sdmmc-wp { */
				&sdmmc_wp {
					rockchip,pins = <0 RK_PB0 1 &pcfg_pull_up>;
				};
				/* spdif_bus: spdif-bus { */
			&spdif_bus {
				rockchip,pins = <4 RK_PC5 1 &pcfg_pull_none>;
				phandle = <0x98>;
			};

			/* spdif_bus_1: spdif-bus-1 { */
			&spdif_bus_1 {
				rockchip,pins = <3 RK_PC0 3 &pcfg_pull_none>;
			};
			/* spi0_clk: spi0-clk { */
				&spi0_clk {
					rockchip,pins = <3 RK_PA6 2 &pcfg_pull_up>;
					phandle = <0x49>;
				};
	
				/* spi0_cs0: spi0-cs0 { */
					&spi0_cs0 {
					rockchip,pins = <3 RK_PA7 2 &pcfg_pull_up>;
					phandle = <0x4c>;
				};
	
				/* spi0_cs1: spi0-cs1 { */
					&spi0_cs1 {
					rockchip,pins = <3 RK_PB0 2 &pcfg_pull_up>;
				};
	
			/* 	spi0_tx: spi0-tx { */
				&spi0_tx {
					rockchip,pins = <3 RK_PA5 2 &pcfg_pull_up>;
					phandle = <0x4a>;
				};
	
				/* spi0_rx: spi0-rx { */
					&spi0_rx {
					rockchip,pins = <3 RK_PA4 2 &pcfg_pull_up>;
					phandle = <0x4b>;
				};
				/* spi1_clk: spi1-clk { */
					&spi1_clk {
						rockchip,pins = <1 RK_PB1 2 &pcfg_pull_up>;
						phandle = <0x4d>;
					};
		
					/* spi1_cs0: spi1-cs0 { */
						&spi1_cs0 {
						rockchip,pins = <1 RK_PB2 2 &pcfg_pull_up>;
						phandle = <0x50>;
					};
		
					/* spi1_rx: spi1-rx { */
						&spi1_rx {
						rockchip,pins = <1 RK_PA7 2 &pcfg_pull_up>;
						phandle = <0x4f>;
					};
		
					/* spi1_tx: spi1-tx { */
						&spi1_tx {
						rockchip,pins = <1 RK_PB0 2 &pcfg_pull_up>;
						phandle = <0x4e>;
					};
					/* spi2_clk: spi2-clk { */
				&spi2_clk {
					rockchip,pins = <2 RK_PB3 1 &pcfg_pull_up>;
					phandle = <0x51>;
				};
	
				/* spi2_cs0: spi2-cs0 { */
					&spi2_cs0 {
					rockchip,pins = <2 RK_PB4 1 &pcfg_pull_up>;
					phandle = <0x54>;
				};
	
				/* spi2_rx: spi2-rx { */
					&spi2_rx {
					rockchip,pins = <2 RK_PB1 1 &pcfg_pull_up>;
					phandle = <0x53>;
				};
	
				/* spi2_tx: spi2-tx { */
					&spi2_tx {
					rockchip,pins = <2 RK_PB2 1 &pcfg_pull_up>;
					phandle = <0x52>;
				};

				/* spi3_clk: spi3-clk { */
					&spi3_clk {
						rockchip,pins = <1 RK_PC1 1 &pcfg_pull_up>;
						phandle = <0x7c>;
					};
		
					/* spi3_cs0: spi3-cs0 { */
						&spi3_cs0 {
						rockchip,pins = <1 RK_PC2 1 &pcfg_pull_up>;
						phandle = <0x7f>;
					};
		
					/* spi3_rx: spi3-rx { */
						&spi3_rx {
						rockchip,pins = <1 RK_PB7 1 &pcfg_pull_up>;
						phandle = <0x7e>;
					};
		
					/* spi3_tx: spi3-tx { */
						&spi3_tx {
						rockchip,pins = <1 RK_PC0 1 &pcfg_pull_up>;
						phandle = <0x7d>;
					};
					/* spi4_clk: spi4-clk { */
				&spi4_clk {
					rockchip,pins = <3 RK_PA2 2 &pcfg_pull_up>;
					phandle = <0x55>;
				};
	
				/* spi4_cs0: spi4-cs0 { */
					&spi4_cs0 {
					rockchip,pins = <3 RK_PA3 2 &pcfg_pull_up>;
					phandle = <0x58>;
				};
	
				/* spi4_rx: spi4-rx { */
					&spi4_rx {
					rockchip,pins = <3 RK_PA0 2 &pcfg_pull_up>;
					phandle = <0x57>;
				};
	
				/* spi4_tx: spi4-tx { */
					&spi4_tx {
					rockchip,pins = <3 RK_PA1 2 &pcfg_pull_up>;
					phandle = <0x56>;
				};
				/* spi5_clk: spi5-clk { */
					&spi5_clk {
						rockchip,pins = <2 RK_PC6 2 &pcfg_pull_up>;
						phandle = <0x59>;
					};
		
					/* spi5_cs0: spi5-cs0 { */
						&spi5_cs0 {
						rockchip,pins = <2 RK_PC7 2 &pcfg_pull_up>;
						phandle = <0x5c>;
					};
		
					/* spi5_rx: spi5-rx { */
						&spi5_rx {
						rockchip,pins = <2 RK_PC4 2 &pcfg_pull_up>;
						phandle = <0x5b>;
					};
		
					/* spi5_tx: spi5-tx { */
						&spi5_tx {
						rockchip,pins = <2 RK_PC5 2 &pcfg_pull_up>;
						phandle = <0x5a>;
					};
					/* otp_pin: otp-gpio { */
				&otp_pin {
					rockchip,pins = <1 RK_PA6 RK_FUNC_GPIO &pcfg_pull_none>;
					phandle = <0x60>;
				};
	
				/* otp_out: otp-out { */
					&otp_out {
					rockchip,pins = <1 RK_PA6 1 &pcfg_pull_none>;
					phandle = <0x61>;
				};
				/* uart0_xfer: uart0-xfer { */
					&uart0_xfer {
						rockchip,pins = 
							<2 RK_PC0 1 &pcfg_pull_up>,
							<2 RK_PC1 1 &pcfg_pull_none>;
						phandle = <0x42>;
					};
		
					/* uart0_cts: uart0-cts { */
						&uart0_cts {
						rockchip,pins = <2 RK_PC2 1 &pcfg_pull_none>;
						phandle = <0x43>;
					};
		
					/* uart0_rts: uart0-rts { */
						&uart0_rts {
						rockchip,pins = <2 RK_PC3 1 &pcfg_pull_none>;
						phandle = <0xde>;
					};
					/* uart1_xfer: uart1-xfer { */

				&uart1_xfer {

					rockchip,pins = 
						<3 RK_PB4 2 &pcfg_pull_up>,
						<3 RK_PB5 2 &pcfg_pull_none>;
					phandle = <0x44>;
				};
				/* uart2a_xfer: uart2a-xfer { */
					&uart2a_xfer {
						rockchip,pins = 
							<4 RK_PB0 2 &pcfg_pull_up>,
							<4 RK_PB1 2 &pcfg_pull_none>;
					};
					/* uart2b_xfer: uart2b-xfer { */
				&uart2b_xfer {
					rockchip,pins = 
						<4 RK_PC0 2 &pcfg_pull_up>,
						<4 RK_PC1 2 &pcfg_pull_none>;
				};
				/* uart2c_xfer: uart2c-xfer { */
					&uart2c_xfer {
						rockchip,pins = 
							<4 RK_PC3 1 &pcfg_pull_up>,
							<4 RK_PC4 1 &pcfg_pull_none>;
						phandle = <0x45>;
					};
					/* uart3_xfer: uart3-xfer { */
				&uart3_xfer {
					rockchip,pins = 
						<3 RK_PB6 2 &pcfg_pull_up>,
						<3 RK_PB7 2 &pcfg_pull_none>;
					phandle = <0x46>;
				};
	
				/* uart3_cts: uart3-cts { */
					&uart3_cts {
					rockchip,pins = <3 RK_PC0 2 &pcfg_pull_none>;
					phandle = <0x47>;
				};
	
				/* uart3_rts: uart3-rts { */
					&uart3_rts {
					rockchip,pins = <3 RK_PC1 2 &pcfg_pull_none>;
					phandle = <0x48>;
				};
				/* uart4_xfer: uart4-xfer { */
					&uart4_xfer {

						rockchip,pins = 
							<1 RK_PA7 1 &pcfg_pull_up>,
							<1 RK_PB0 1 &pcfg_pull_none>;
						phandle = <0x80>;
					};
					/* uarthdcp_xfer: uarthdcp-xfer { */
				&uarthdcp_xfer {

					rockchip,pins = 
						<4 RK_PC5 2 &pcfg_pull_up>,
						<4 RK_PC6 2 &pcfg_pull_none>;
				};

				
			/* pwm0_pin: pwm0-pin { */
				&pwm0_pin {
					rockchip,pins = 
					<4 RK_PC2 1 &pcfg_pull_none>;
					phandle = <0x88>;
				};
	
				/* vop0_pwm_pin: vop0-pwm-pin { */
					&vop0_pwm_pin {
					rockchip,pins = <4 RK_PC2 2 &pcfg_pull_none>;
					phandle = <0xaa>;
				};
	
				/* vop1_pwm_pin: vop1-pwm-pin { */
					&vop1_pwm_pin {
					rockchip,pins = <4 RK_PC2 3 &pcfg_pull_none>;
					phandle = <0xa3>;
				};
				/* pwm1_pin: pwm1-pin { */
					&pwm1_pin {
						rockchip,pins = <4 RK_PC6 1 &pcfg_pull_none>;
						phandle = <0x89>;
					};

					/* pwm2_pin: pwm2-pin { */
				&pwm2_pin {
					rockchip,pins = <1 RK_PC3 1 &pcfg_pull_none>;
					phandle = <0x8a>;
				};
				/* pwm3a_pin: pwm3a-pin { */
					&pwm3a_pin {
						rockchip,pins = <0 RK_PA6 1 &pcfg_pull_none>;
						phandle = <0x8b>;
					};

					/* pwm3b_pin: pwm3b-pin { */
				&pwm3b_pin { 
					rockchip,pins = <1 RK_PB6 1 &pcfg_pull_none>;
				};
				/* edp_hpd: edp-hpd { */
					&edp_hpd {
						rockchip,pins = <0x04 0x17 0x02 0xc2>;
						phandle = <0xb8>;
					};

					/* hdmi_i2c_xfer: hdmi-i2c-xfer { */
			&hdmi_i2c_xfer {
				rockchip,pins = 
					<4 RK_PC1 3 &pcfg_pull_none>,
					<4 RK_PC0 3 &pcfg_pull_none>;
				phandle = <0xae>;
			};

			/* hdmi_cec: hdmi-cec { */
				&hdmi_cec {
				rockchip,pins = <0x04 0x17 0x01 0xc2>;
			};
			/* pcie_clkreqn_cpm: pci-clkreqn-cpm { */
				&pcie_clkreqn_cpm {

					rockchip,pins = <2 RK_PD2 RK_FUNC_GPIO &pcfg_pull_none>;
				};
	
				/* pcie_clkreqnb_cpm: pci-clkreqnb-cpm { */
					&pcie_clkreqnb_cpm {
					/*rockchip,pins = <0x04 0x18 0x00 0xc2>;*/
					rockchip,pins =
						<4 RK_PD0 RK_FUNC_GPIO &pcfg_pull_none>;
				};
				/* pmic_int_l: pmic-int-l { */
					&pmic_int_l { 
						rockchip,pins = <0x01 0x15 0x00 0xc0>;
						phandle = <0x36>;
					};
		
					/* pmic_dvs2: pmic-dvs2 { */
						&pmic_dvs2 {
						rockchip,pins = <0x01 0x05 0x00 0xc4>;
						phandle = <0x37>;
					};
	/*pinctrl: pinctrl {*/
	&pinctrl {
		//compatible = "rockchip,rk3399-pinctrl";
		//rockchip,grf = <&grf>;
		//rockchip,pmu = <&pmugrf>;
		//#address-cells = <0x02>;
		//#size-cells = <0x02>;
		//ranges;


		pcfg-input {
			input-enable;
		};

		emmc {
			emmc-pwr {
				rockchip,pins = <0x00 0x05 0x01 0xc0>;
			};
		};


		i2c3 {

			i2c3_gpio {
				rockchip,pins = <0x04 0x11 0x00 0xc2 0x04 0x10 0x00 0xc2>;
			};
		};

		i2s0 {
			i2s-8ch-mclk {
				rockchip,pins = <0x04 0x00 0x01 0xc2>;
				phandle = <0x3a>;
			};
		};
		pcie {
			pci-clkreqn {
				rockchip,pins = <0x02 0x1a 0x02 0xc2>;
			};

			pci-clkreqnb {
				rockchip,pins = <0x04 0x18 0x01 0xc2>;
			};
		};

		isp {

			cif-clkout {
				rockchip,pins = <0x02 0x0b 0x03 0xc2>;
				phandle = <0xc8>;
			};

			isp-dvp-d0d7 {
				rockchip,pins = <0x02 0x00 0x03 0xc2 0x02 0x01 0x03 0xc2 0x02 0x02 0x03 0xc2 0x02 0x03 0x03 0xc2 0x02 0x04 0x03 0xc2 0x02 0x05 0x03 0xc2 0x02 0x06 0x03 0xc2 0x02 0x07 0x03 0xc2 0x02 0x08 0x03 0xc2 0x02 0x09 0x03 0xc2 0x02 0x0a 0x03 0xc2>;
				phandle = <0xc9>;
			};

			isp-shutter {
				rockchip,pins = <0x01 0x01 0x01 0xc2 0x01 0x00 0x01 0xc2>;
			};

			isp-prelight {
				rockchip,pins = <0x01 0x04 0x01 0xc2>;
				phandle = <0xca>;
			};
		};

		sdio-pwrseq {

			wifi-enable-h {
				rockchip,pins = <0x00 0x0a 0x00 0xc2>;
				phandle = <0xdc>;
			};
		};

		wireless-bluetooth {

			uart0-gpios {
				rockchip,pins = <0x02 0x13 0x00 0xc2>;
				phandle = <0xdf>;
			};
		};

		pmic {
			vsel1-gpio {
				rockchip,pins = <0x01 0x11 0x00 0xc4>;
				phandle = <0x33>;
			};

			vsel2-gpio {
				rockchip,pins = <0x01 0x0e 0x00 0xc4>;
				phandle = <0x35>;
			};
		};

		backlight_pwr_en {

			bl-en-gpio {
				rockchip,pins = <0x01 0x01 0x00 0xc0>;
			};
		};

		edp_panel_pwr_en {

			mipi-lcd-en-gpio {
				rockchip,pins = <0x04 0x1a 0x00 0xc0>;
			};
		};

		mipi_panel {

			mipi-lcd-en-gpio {
				rockchip,pins = <0x01 0x0d 0x00 0xc0>;
			};

			mipi-lcd-pwr-gpio {
				rockchip,pins = <0x01 0x12 0x00 0xc0>;
			};

			mipi-lcd-rst-gpio {
				rockchip,pins = <0x00 0x0c 0x00 0xc0>;
			};
		};

		headphone {

			hp-det {
				rockchip,pins = <0x04 0x1c 0x00 0xc0>;
				phandle = <0xe0>;
			};
		};

		spk_amp {

			spk-amp-en {
				rockchip,pins = <0x00 0x0b 0x00 0xc0>;
			};
		};

		wk2124 {

			wk2124-irq-gpio {
				rockchip,pins = <0x01 0x02 0x00 0xc2>;
			};

			wk2124-rst-gpio {
				rockchip,pins = <0x01 0x00 0x00 0xc0>;
			};
		};

		usb_host {

			host-vbus-drv {
				rockchip,pins = <0x04 0x1d 0x00 0xc2>;
				phandle = <0xd4>;
			};
		};

		usb_otg {

			fusb0-int {
				rockchip,pins = <0x01 0x17 0x00 0xc0>;
				phandle = <0x82>;
			};

			otg-vbus-drv {
				rockchip,pins = <0x04 0x19 0x00 0xc2>;
			};
		};

		modem_pwr {

			modem-pwr_en {
				rockchip,pins = <0x00 0x0d 0x00 0xc0>;
			};

			modem-pwr_rst {
				rockchip,pins = <0x01 0x00 0x00 0xc0>;
			};
		};

		gt9xx {

			gt9xx-irq-gpio {
				rockchip,pins = <0x04 0x18 0x00 0xc0>;
			};

			gt9xx-rst-gpio {
				rockchip,pins = <0x04 0x16 0x00 0xc0>;
			};
		};

		efuse {

			efuse-pwr-gpio {
				rockchip,pins = <0x01 0x14 0x00 0xc0>;
			};
		};

		camera {

			flash-led-gpio {
				rockchip,pins = <0x01 0x03 0x00 0xc0>;
			};

			camera0-pwdn-gpio {
				rockchip,pins = <0x02 0x1b 0x00 0xc0>;
			};

			camera1-pwdn-gpio {
				rockchip,pins = <0x03 0x1c 0x00 0xc0>;
			};

			camera0-rst-gpio {
				rockchip,pins = <0x02 0x08 0x00 0xc0>;
			};

			camera1-rst-gpio {
				rockchip,pins = <0x02 0x0c 0x00 0xc0>;
			};
		};

		sys_led {

			sys-led-gpio {
				rockchip,pins = <0x01 0x18 0x00 0xc0>;
			};
		};

		oem_gpio {

			oem-gpio-0 {
				rockchip,pins = <0x02 0x00 0x00 0xc0>;
			};

			oem-gpio-1 {
				rockchip,pins = <0x02 0x01 0x00 0xc0>;
			};

			oem-gpio-2 {
				rockchip,pins = <0x02 0x02 0x00 0xc0>;
			};

			oem-gpio-3 {
				rockchip,pins = <0x02 0x03 0x00 0xc0>;
			};

			oem-gpio-4 {
				rockchip,pins = <0x02 0x04 0x00 0xc0>;
			};

			oem-gpio-5 {
				rockchip,pins = <0x02 0x05 0x00 0xc0>;
			};

			oem-gpio-6 {
				rockchip,pins = <0x02 0x06 0x00 0xc0>;
			};

			oem-gpio-7 {
				rockchip,pins = <0x02 0x07 0x00 0xc0>;
			};
		};
	};

	
	/* cluster0_opp: opp-table0 { */
		&cluster0_opp {
		compatible = "operating-points-v2";
		opp-shared;
		rockchip,temp-hysteresis = <0x1388>;
		rockchip,low-temp = <0x2710>;
		rockchip,low-temp-min-volt = <0xdbba0>;
		nvmem-cells = <0xce 0xcf>;
		nvmem-cell-names = "cpu_leakage\0specification_serial_number";
		clocks = <&cru 0x01>;
		rockchip,avs-scale = <0x14>;
		rockchip,bin-scaling-sel = <0x00 0x1e 0x01 0x22>;
		rockchip,pvtm-voltage-sel = <0x00 0x2308c 0x00 0x2308d 0x24414 0x01 0x24415 0x251c0 0x02 0x251c1 0xf423f 0x03>;
		rockchip,pvtm-freq = <0x639c0>;
		rockchip,pvtm-volt = <0xf4240>;
		rockchip,pvtm-ch = <0x00 0x00>;
		rockchip,pvtm-sample-time = <0x3e8>;
		rockchip,pvtm-number = <0x0a>;
		rockchip,pvtm-error = <0x3e8>;
		rockchip,pvtm-ref-temp = <0x29>;
		rockchip,pvtm-temp-prop = <0x73 0x42>;
		rockchip,thermal-zone = "soc-thermal";
		phandle = <0x0b>;

		opp-408000000 {
			opp-hz = <0x00 0x18519600>;
			opp-microvolt = <0xc3500 0xc3500 0x1312d0>;
			opp-microvolt-L0 = <0xc3500 0xc3500 0x1312d0>;
			opp-microvolt-L1 = <0xc3500 0xc3500 0x1312d0>;
			opp-microvolt-L2 = <0xc3500 0xc3500 0x1312d0>;
			opp-microvolt-L3 = <0xc3500 0xc3500 0x1312d0>;
			clock-latency-ns = <0x9c40>;
		};

		opp-600000000 {
			opp-hz = <0x00 0x23c34600>;
			opp-microvolt = <0xc3500 0xc3500 0x1312d0>;
			opp-microvolt-L0 = <0xc3500 0xc3500 0x1312d0>;
			opp-microvolt-L1 = <0xc3500 0xc3500 0x1312d0>;
			opp-microvolt-L2 = <0xc3500 0xc3500 0x1312d0>;
			opp-microvolt-L3 = <0xc3500 0xc3500 0x1312d0>;
			clock-latency-ns = <0x9c40>;
		};

		opp-816000000 {
			opp-hz = <0x00 0x30a32c00>;
			opp-microvolt = <0xcf850 0xcf850 0x1312d0>;
			opp-microvolt-L0 = <0xcf850 0xcf850 0x1312d0>;
			opp-microvolt-L1 = <0xc96a8 0xc96a8 0x1312d0>;
			opp-microvolt-L2 = <0xc3500 0xc3500 0x1312d0>;
			opp-microvolt-L3 = <0xc3500 0xc3500 0x1312d0>;
			clock-latency-ns = <0x9c40>;
			opp-suspend;
		};

		opp-1008000000 {
			opp-hz = <0x00 0x3c14dc00>;
			opp-microvolt = <0xe1d48 0xe1d48 0x1312d0>;
			opp-microvolt-L0 = <0xe1d48 0xe1d48 0x1312d0>;
			opp-microvolt-L1 = <0xdbba0 0xdbba0 0x1312d0>;
			opp-microvolt-L2 = <0xd59f8 0xd59f8 0x1312d0>;
			opp-microvolt-L3 = <0xcf850 0xcf850 0x1312d0>;
			clock-latency-ns = <0x9c40>;
		};

		opp-1200000000 {
			opp-hz = <0x00 0x47868c00>;
			opp-microvolt = <0xf4240 0xf4240 0x1312d0>;
			opp-microvolt-L0 = <0xf4240 0xf4240 0x1312d0>;
			opp-microvolt-L1 = <0xee098 0xee098 0x1312d0>;
			opp-microvolt-L2 = <0xe7ef0 0xe7ef0 0x1312d0>;
			opp-microvolt-L3 = <0xe1d48 0xe1d48 0x1312d0>;
			clock-latency-ns = <0x9c40>;
		};

		opp-1416000000 {
			opp-hz = <0x00 0x54667200>;
			opp-microvolt = <0x112a88 0x112a88 0x1312d0>;
			opp-microvolt-L0 = <0x112a88 0x112a88 0x1312d0>;
			opp-microvolt-L1 = <0x10c8e0 0x10c8e0 0x1312d0>;
			opp-microvolt-L2 = <0x106738 0x106738 0x1312d0>;
			opp-microvolt-L3 = <0x100590 0x100590 0x1312d0>;
			clock-latency-ns = <0x9c40>;
		};
	};

	/* cluster1_opp: opp-table1 { */
		&cluster1_opp {
		compatible = "operating-points-v2";
		opp-shared;
		rockchip,temp-hysteresis = <0x1388>;
		rockchip,low-temp = <0x2710>;
		rockchip,low-temp-min-volt = <0xdbba0>;
		nvmem-cells = <0xd0 0xcf>;
		nvmem-cell-names = "cpu_leakage\0specification_serial_number";
		clocks = <&cru 0x02>;
		rockchip,avs-scale = <0x08>;
		rockchip,bin-scaling-sel = <0x00 0x08 0x01 0x11>;
		rockchip,pvtm-voltage-sel = <0x00 0x24608 0x00 0x24609 0x25d78 0x01 0x25d79 0x27100 0x02 0x27101 0xf423f 0x03>;
		rockchip,pvtm-freq = <0x639c0>;
		rockchip,pvtm-volt = <0xf4240>;
		rockchip,pvtm-ch = <0x01 0x00>;
		rockchip,pvtm-sample-time = <0x3e8>;
		rockchip,pvtm-number = <0x0a>;
		rockchip,pvtm-error = <0x3e8>;
		rockchip,pvtm-ref-temp = <0x29>;
		rockchip,pvtm-temp-prop = <0x47 0x23>;
		rockchip,thermal-zone = "soc-thermal";
		phandle = <0x0f>;

		opp-408000000 {
			opp-hz = <0x00 0x18519600>;
			opp-microvolt = <0xc3500 0xc3500 0x1312d0>;
			opp-microvolt-L0 = <0xc3500 0xc3500 0x1312d0>;
			opp-microvolt-L1 = <0xc3500 0xc3500 0x1312d0>;
			opp-microvolt-L2 = <0xc3500 0xc3500 0x1312d0>;
			opp-microvolt-L3 = <0xc3500 0xc3500 0x1312d0>;
			clock-latency-ns = <0x9c40>;
		};

		opp-600000000 {
			opp-hz = <0x00 0x23c34600>;
			opp-microvolt = <0xc3500 0xc3500 0x1312d0>;
			opp-microvolt-L0 = <0xc3500 0xc3500 0x1312d0>;
			opp-microvolt-L1 = <0xc3500 0xc3500 0x1312d0>;
			opp-microvolt-L2 = <0xc3500 0xc3500 0x1312d0>;
			opp-microvolt-L3 = <0xc3500 0xc3500 0x1312d0>;
			clock-latency-ns = <0x9c40>;
		};

		opp-816000000 {
			opp-hz = <0x00 0x30a32c00>;
			opp-microvolt = <0xc96a8 0xc96a8 0x1312d0>;
			opp-microvolt-L0 = <0xc96a8 0xc96a8 0x1312d0>;
			opp-microvolt-L1 = <0xc96a8 0xc96a8 0x1312d0>;
			opp-microvolt-L2 = <0xc3500 0xc3500 0x1312d0>;
			opp-microvolt-L3 = <0xc3500 0xc3500 0x1312d0>;
			clock-latency-ns = <0x9c40>;
			opp-suspend;
		};

		opp-1008000000 {
			opp-hz = <0x00 0x3c14dc00>;
			opp-microvolt = <0xd59f8 0xd59f8 0x1312d0>;
			opp-microvolt-L0 = <0xd59f8 0xd59f8 0x1312d0>;
			opp-microvolt-L1 = <0xcf850 0xcf850 0x1312d0>;
			opp-microvolt-L2 = <0xcf850 0xcf850 0x1312d0>;
			opp-microvolt-L3 = <0xcf850 0xcf850 0x1312d0>;
			clock-latency-ns = <0x9c40>;
		};

		opp-1200000000 {
			opp-hz = <0x00 0x47868c00>;
			opp-microvolt = <0xe7ef0 0xe7ef0 0x1312d0>;
			opp-microvolt-L0 = <0xe7ef0 0xe7ef0 0x1312d0>;
			opp-microvolt-L1 = <0xe1d48 0xe1d48 0x1312d0>;
			opp-microvolt-L2 = <0xdbba0 0xdbba0 0x1312d0>;
			opp-microvolt-L3 = <0xd59f8 0xd59f8 0x1312d0>;
			clock-latency-ns = <0x9c40>;
		};

		opp-1416000000 {
			opp-hz = <0x00 0x54667200>;
			opp-microvolt = <0xfa3e8 0xfa3e8 0x1312d0>;
			opp-microvolt-L0 = <0xfa3e8 0xfa3e8 0x1312d0>;
			opp-microvolt-L1 = <0xf4240 0xf4240 0x1312d0>;
			opp-microvolt-L2 = <0xf4240 0xf4240 0x1312d0>;
			opp-microvolt-L3 = <0xee098 0xee098 0x1312d0>;
			clock-latency-ns = <0x9c40>;
		};

		opp-1608000000 {
			opp-hz = <0x00 0x5fd82200>;
			opp-microvolt = <0x10c8e0 0x10c8e0 0x1312d0>;
			opp-microvolt-L0 = <0x10c8e0 0x10c8e0 0x1312d0>;
			opp-microvolt-L1 = <0x106738 0x106738 0x1312d0>;
			opp-microvolt-L2 = <0x100590 0x100590 0x1312d0>;
			opp-microvolt-L3 = <0xfa3e8 0xfa3e8 0x1312d0>;
			clock-latency-ns = <0x9c40>;
		};

		opp-1800000000 {
			opp-hz = <0x00 0x6b49d200>;
			opp-microvolt = <0x124f80 0x124f80 0x1312d0>;
			opp-microvolt-L0 = <0x124f80 0x124f80 0x1312d0>;
			opp-microvolt-L1 = <0x11edd8 0x11edd8 0x1312d0>;
			opp-microvolt-L2 = <0x118c30 0x118c30 0x1312d0>;
			opp-microvolt-L3 = <0x112a88 0x112a88 0x1312d0>;
			clock-latency-ns = <0x9c40>;
		};
	};

	/* gpu_opp_table: opp-table2 { */
		&gpu_opp_table {
		compatible = "operating-points-v2";
		rockchip,thermal-zone = "soc-thermal";
		rockchip,temp-hysteresis = <0x1388>;
		rockchip,low-temp = <0x2710>;
		rockchip,low-temp-min-volt = <0xdbba0>;
		nvmem-cells = <0xd1>;
		nvmem-cell-names = "gpu_leakage";
		rockchip,pvtm-voltage-sel = <0x00 0x1d8a8 0x00 0x1d8a9 0x1ea3c 0x01 0x1ea3d 0x1f5f4 0x02 0x1f5f5 0xf423f 0x03>;
		rockchip,pvtm-freq = <0x30d40>;
		rockchip,pvtm-volt = <0xdbba0>;
		rockchip,pvtm-ch = <0x03 0x00>;
		rockchip,pvtm-sample-time = <0x3e8>;
		rockchip,pvtm-number = <0x0a>;
		rockchip,pvtm-error = <0x3e8>;
		rockchip,pvtm-ref-temp = <0x29>;
		rockchip,pvtm-temp-prop = <0x2e 0x0c>;
		rockchip,pvtm-thermal-zone = "gpu-thermal";
		phandle = <0x9b>;

		opp-200000000 {
			opp-hz = <0x00 0xbebc200>;
			opp-microvolt = "\0\f5";
			opp-microvolt-L0 = "\0\f5";
			opp-microvolt-L1 = "\0\f5";
			opp-microvolt-L2 = "\0\f5";
			opp-microvolt-L3 = "\0\f5";
		};

		opp-300000000 {
			opp-hz = <0x00 0x11e1a300>;
			opp-microvolt = "\0\f5";
			opp-microvolt-L0 = "\0\f5";
			opp-microvolt-L1 = "\0\f5";
			opp-microvolt-L2 = "\0\f5";
			opp-microvolt-L3 = "\0\f5";
		};

		opp-400000000 {
			opp-hz = <0x00 0x17d78400>;
			opp-microvolt = <0xc96a8>;
			opp-microvolt-L0 = <0xc96a8>;
			opp-microvolt-L1 = <0xc96a8>;
			opp-microvolt-L2 = "\0\f5";
			opp-microvolt-L3 = "\0\f5";
		};

		opp-600000000 {
			opp-hz = <0x00 0x23c34600>;
			opp-microvolt = <0xe1d48>;
			opp-microvolt-L0 = <0xe1d48>;
			opp-microvolt-L1 = <0xe1d48>;
			opp-microvolt-L2 = <0xdbba0>;
			opp-microvolt-L3 = <0xdbba0>;
		};

		opp-800000000 {
			opp-hz = <0x00 0x2faf0800>;
			opp-microvolt = <0x10c8e0>;
			opp-microvolt-L0 = <0x10c8e0>;
			opp-microvolt-L1 = <0x106738>;
			opp-microvolt-L2 = <0x100590>;
			opp-microvolt-L3 = <0xfa3e8>;
		};
	};

	/* sdio_pwrseq: sdio-pwrseq { */
		&sdio_pwrseq {
		compatible = "mmc-pwrseq-simple";
		clocks = <&rk808 1>;
		clock-names = "ext_clock";
		pinctrl-names = "default";
		pinctrl-0 = <0xdc>;
		reset-gpios = <0x3b 0x0a 0x01>;
		phandle = <0x1b>;
	};

	/* vcc3v3_sys: vcc3v3-sys { */
		&vcc3v3_sys {
		compatible = "regulator-fixed";
		regulator-name = "vcc3v3_sys";
		regulator-always-on;
		regulator-boot-on;
		regulator-min-microvolt = <3300000>;
		regulator-max-microvolt = <3300000>;
		phandle = <0x32>;
	};

	/* vcc_phy: vcc-phy-regulator { */
		&vcc_phy {
		compatible = "regulator-fixed";
		regulator-name = "vcc_phy";
		regulator-always-on;
		regulator-boot-on;
		phandle = <0x17>;
	};
	&hdmi-sound {
		status = "okay";
		//compatible = "simple-audio-card";
		//simple-audio-card,format = "i2s";
		//simple-audio-card,mclk-fs = <0x100>;
		//simple-audio-card,name = "rockchip,hdmi";

		//simple-audio-card,cpu {
		//	sound-dai = <0xcb>;
		//};

		//simple-audio-card,codec {
		//	sound-dai = <0xcc>;
		//};
	};